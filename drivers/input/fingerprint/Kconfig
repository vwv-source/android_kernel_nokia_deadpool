## drivers/input/fingerprint/Kconfig
```kconfig
#
# Configuration for FP
#
menuconfig INPUT_FINGERPRINT
	bool "Fingerprints"
	help
	  Say Y here, and a list of supported fingerprints will be displayed.

if INPUT_FINGERPRINT

source "drivers/input/fingerprint/goodix_fp/Kconfig"

endif
```

## drivers/input/fingerprint/goodix_fp/Kconfig
```kconfig
#
# Configuration for Goodix Fingerprint
#
config INPUT_GXFP
	bool "Goodix Fingerprint Driver"
	default n
	help
	  This is a Goodix Fingerprint chipset Driver.
```
