/*
 * Copyright (c) 2018, The Linux Foundation. All rights reserved.
 *
 * This program is free software; you can redistribute it and/or modify
 * it under the terms of the GNU General Public License version 2 and
 * only version 2 as published by the Free Software Foundation.
 *
 * This program is distributed in the hope that it will be useful,
 * but WITHOUT ANY WARRANTY; without even the implied warranty of
 * MERCHANTABILITY or FITNESS FOR A PARTICULAR PURPOSE.  See the
 * GNU General Public License for more details.
 */

/dts-v1/;
/plugin/;

#include <dt-bindings/clock/msm-clocks-8952.h>
#include "../qcom/sdm429-mtp.dtsi"

#include "nbb/rhd-EVT1.dtsi"

/ {
	model = "SDM429 MTP RHD EVT1";
	compatible = "qcom,sdm429-mtp", "qcom,sdm429", "qcom,mtp";
	qcom,msm-id = <354 0x0>;
	qcom,board-id = <8 0>;
  fih,hw-id = <2 1 2>;
};
