&soc {
	gf3258 {
		compatible = "goodix,fingerprint";
		status = "okay";
		interrupt-parent = <&tlmm>;
		interrupts = <0 48 0>;
		fp-gpio-reset = <&tlmm 68 0x0>;
		fp-gpio-irq = <&tlmm 48 0x0>;
		goodix,key-customer-define = <1>;
		vdd_io-supply = <&fp_avdd_vreg>;
	};
};
