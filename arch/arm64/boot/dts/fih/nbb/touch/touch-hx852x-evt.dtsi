&i2c_3 {
status = "okay";
    himax-ts@48 {
            compatible = "himax,hxcommon";
            reg = <0x48>;
            interrupt-parent = <&tlmm>;
            interrupts = <65 0x2>;
            vcc_ana-supply = <&pm8953_l22>; //EVT Used L22
            himax,rst-gpio = <&tlmm 64 0x00>;
            himax,irq-gpio = <&tlmm 65 0x00>;
            himax,display-coords =  <0 720 0 1440>;
            himax,panel-coords = <0 720 0 1440>;
    };
};

&pm8953_l22 {
    regulator-min-microvolt = <3000000>;
    regulator-max-microvolt = <3000000>;
    qcom,init-voltage = <3000000>;
};
