/*
 * Copyright (C) 2010 - 2017 Novatek, Inc.
 *
 * $Revision: 30063 $
 * $Date: 2018-06-25 15:58:18 +0800 (?变?, 25 ?? 2018) $
 *
 * This program is free software; you can redistribute it and/or modify
 * it under the terms of the GNU General Public License as published by
 * the Free Software Foundation; either version 2 of the License, or
 * (at your option) any later version.
 *
 * This program is distributed in the hope that it will be useful, but WITHOUT
 * ANY WARRANTY; without even the implied warranty of MERCHANTABILITY or
 * FITNESS FOR A PARTICULAR PURPOSE.  See the GNU General Public License for
 * more details.
 *
 */


&i2c_3 {
	status = "ok";

	/* Novatek device tree node */
	novatek@62 {
		compatible = "novatek,NVT-ts";
		reg = <0x62>;
		status = "ok";
		interrupt-parent = <&tlmm>;
		interrupts = <65 0x2>;
//		vdd-supply = <&pm8994_lvs2>;    //VDDIO
//		avdd-supply = <&pm8994_l22>;    //VDD

		novatek,reset-gpio = <&tlmm 64 0x01>;
		novatek,irq-gpio = <&tlmm 65 0x02>;

		/* MP */
		novatek,mp-support-dt;

		novatek-mp-criteria-7101@0 {
			#address-cells = <1>;
			#size-cells = <0>;
			compatible = "novatek-mp-criteria-7101";

			/* MP Config */
			IC_X_CFG_SIZE = <18>;
			IC_Y_CFG_SIZE = <32>;
			IC_KEY_CFG_SIZE = <4>;
			X_Channel = <18>;
			Y_Channel = <32>;
			AIN_X = <0 1 2 3 4 5 6 7 8 9 10 11 12 13 14 15 16 17>;
			AIN_Y = <0 1 2 3 4 5 6 7 8 9 10 11 12 13 14 15 16
								17 18 19 20 21 22 23 24 25 26 27 28 29 30 31>;
			AIN_KEY = <0 1 2 0xFF>;

			/* MP Criteria */
			PS_Config_Lmt_Short_Rawdata_P = <
				14008	14008	14008	14008	14008	14008	14008	14008	14008	14008	14008	14008	14008	14008	14008	14008	14008	14008
				14008	14008	14008	14008	14008	14008	14008	14008	14008	14008	14008	14008	14008	14008	14008	14008	14008	14008
				14008	14008	14008	14008	14008	14008	14008	14008	14008	14008	14008	14008	14008	14008	14008	14008	14008	14008
				14008	14008	14008	14008	14008	14008	14008	14008	14008	14008	14008	14008	14008	14008	14008	14008	14008	14008
				14008	14008	14008	14008	14008	14008	14008	14008	14008	14008	14008	14008	14008	14008	14008	14008	14008	14008
				14008	14008	14008	14008	14008	14008	14008	14008	14008	14008	14008	14008	14008	14008	14008	14008	14008	14008
				14008	14008	14008	14008	14008	14008	14008	14008	14008	14008	14008	14008	14008	14008	14008	14008	14008	14008
				14008	14008	14008	14008	14008	14008	14008	14008	14008	14008	14008	14008	14008	14008	14008	14008	14008	14008
				14008	14008	14008	14008	14008	14008	14008	14008	14008	14008	14008	14008	14008	14008	14008	14008	14008	14008
				14008	14008	14008	14008	14008	14008	14008	14008	14008	14008	14008	14008	14008	14008	14008	14008	14008	14008
				14008	14008	14008	14008	14008	14008	14008	14008	14008	14008	14008	14008	14008	14008	14008	14008	14008	14008
				14008	14008	14008	14008	14008	14008	14008	14008	14008	14008	14008	14008	14008	14008	14008	14008	14008	14008
				14008	14008	14008	14008	14008	14008	14008	14008	14008	14008	14008	14008	14008	14008	14008	14008	14008	14008
				14008	14008	14008	14008	14008	14008	14008	14008	14008	14008	14008	14008	14008	14008	14008	14008	14008	14008
				14008	14008	14008	14008	14008	14008	14008	14008	14008	14008	14008	14008	14008	14008	14008	14008	14008	14008
				14008	14008	14008	14008	14008	14008	14008	14008	14008	14008	14008	14008	14008	14008	14008	14008	14008	14008
				14008	14008	14008	14008	14008	14008	14008	14008	14008	14008	14008	14008	14008	14008	14008	14008	14008	14008
				14008	14008	14008	14008	14008	14008	14008	14008	14008	14008	14008	14008	14008	14008	14008	14008	14008	14008
				14008	14008	14008	14008	14008	14008	14008	14008	14008	14008	14008	14008	14008	14008	14008	14008	14008	14008
				14008	14008	14008	14008	14008	14008	14008	14008	14008	14008	14008	14008	14008	14008	14008	14008	14008	14008
				14008	14008	14008	14008	14008	14008	14008	14008	14008	14008	14008	14008	14008	14008	14008	14008	14008	14008
				14008	14008	14008	14008	14008	14008	14008	14008	14008	14008	14008	14008	14008	14008	14008	14008	14008	14008
				14008	14008	14008	14008	14008	14008	14008	14008	14008	14008	14008	14008	14008	14008	14008	14008	14008	14008
				14008	14008	14008	14008	14008	14008	14008	14008	14008	14008	14008	14008	14008	14008	14008	14008	14008	14008
				14008	14008	14008	14008	14008	14008	14008	14008	14008	14008	14008	14008	14008	14008	14008	14008	14008	14008
				14008	14008	14008	14008	14008	14008	14008	14008	14008	14008	14008	14008	14008	14008	14008	14008	14008	14008
				14008	14008	14008	14008	14008	14008	14008	14008	14008	14008	14008	14008	14008	14008	14008	14008	14008	14008
				14008	14008	14008	14008	14008	14008	14008	14008	14008	14008	14008	14008	14008	14008	14008	14008	14008	14008
				14008	14008	14008	14008	14008	14008	14008	14008	14008	14008	14008	14008	14008	14008	14008	14008	14008	14008
				14008	14008	14008	14008	14008	14008	14008	14008	14008	14008	14008	14008	14008	14008	14008	14008	14008	14008
				14008	14008	14008	14008	14008	14008	14008	14008	14008	14008	14008	14008	14008	14008	14008	14008	14008	14008
				14008	14008	14008	14008	14008	14008	14008	14008	14008	14008	14008	14008	14008	14008	14008	14008	14008	14008>;

			PS_Config_Lmt_Short_Rawdata_N = <
				11376	11376	11376	11376	11376	11376	11376	11376	11376	11376	11376	11376	11376	11376	11376	11376	11376	11376
				11376	11376	11376	11376	11376	11376	11376	11376	11376	11376	11376	11376	11376	11376	11376	11376	11376	11376
				11376	11376	11376	11376	11376	11376	11376	11376	11376	11376	11376	11376	11376	11376	11376	11376	11376	11376
				11376	11376	11376	11376	11376	11376	11376	11376	11376	11376	11376	11376	11376	11376	11376	11376	11376	11376
				11376	11376	11376	11376	11376	11376	11376	11376	11376	11376	11376	11376	11376	11376	11376	11376	11376	11376
				11376	11376	11376	11376	11376	11376	11376	11376	11376	11376	11376	11376	11376	11376	11376	11376	11376	11376
				11376	11376	11376	11376	11376	11376	11376	11376	11376	11376	11376	11376	11376	11376	11376	11376	11376	11376
				11376	11376	11376	11376	11376	11376	11376	11376	11376	11376	11376	11376	11376	11376	11376	11376	11376	11376
				11376	11376	11376	11376	11376	11376	11376	11376	11376	11376	11376	11376	11376	11376	11376	11376	11376	11376
				11376	11376	11376	11376	11376	11376	11376	11376	11376	11376	11376	11376	11376	11376	11376	11376	11376	11376
				11376	11376	11376	11376	11376	11376	11376	11376	11376	11376	11376	11376	11376	11376	11376	11376	11376	11376
				11376	11376	11376	11376	11376	11376	11376	11376	11376	11376	11376	11376	11376	11376	11376	11376	11376	11376
				11376	11376	11376	11376	11376	11376	11376	11376	11376	11376	11376	11376	11376	11376	11376	11376	11376	11376
				11376	11376	11376	11376	11376	11376	11376	11376	11376	11376	11376	11376	11376	11376	11376	11376	11376	11376
				11376	11376	11376	11376	11376	11376	11376	11376	11376	11376	11376	11376	11376	11376	11376	11376	11376	11376
				11376	11376	11376	11376	11376	11376	11376	11376	11376	11376	11376	11376	11376	11376	11376	11376	11376	11376
				11376	11376	11376	11376	11376	11376	11376	11376	11376	11376	11376	11376	11376	11376	11376	11376	11376	11376
				11376	11376	11376	11376	11376	11376	11376	11376	11376	11376	11376	11376	11376	11376	11376	11376	11376	11376
				11376	11376	11376	11376	11376	11376	11376	11376	11376	11376	11376	11376	11376	11376	11376	11376	11376	11376
				11376	11376	11376	11376	11376	11376	11376	11376	11376	11376	11376	11376	11376	11376	11376	11376	11376	11376
				11376	11376	11376	11376	11376	11376	11376	11376	11376	11376	11376	11376	11376	11376	11376	11376	11376	11376
				11376	11376	11376	11376	11376	11376	11376	11376	11376	11376	11376	11376	11376	11376	11376	11376	11376	11376
				11376	11376	11376	11376	11376	11376	11376	11376	11376	11376	11376	11376	11376	11376	11376	11376	11376	11376
				11376	11376	11376	11376	11376	11376	11376	11376	11376	11376	11376	11376	11376	11376	11376	11376	11376	11376
				11376	11376	11376	11376	11376	11376	11376	11376	11376	11376	11376	11376	11376	11376	11376	11376	11376	11376
				11376	11376	11376	11376	11376	11376	11376	11376	11376	11376	11376	11376	11376	11376	11376	11376	11376	11376
				11376	11376	11376	11376	11376	11376	11376	11376	11376	11376	11376	11376	11376	11376	11376	11376	11376	11376
				11376	11376	11376	11376	11376	11376	11376	11376	11376	11376	11376	11376	11376	11376	11376	11376	11376	11376
				11376	11376	11376	11376	11376	11376	11376	11376	11376	11376	11376	11376	11376	11376	11376	11376	11376	11376
				11376	11376	11376	11376	11376	11376	11376	11376	11376	11376	11376	11376	11376	11376	11376	11376	11376	11376
				11376	11376	11376	11376	11376	11376	11376	11376	11376	11376	11376	11376	11376	11376	11376	11376	11376	11376
				11376	11376	11376	11376	11376	11376	11376	11376	11376	11376	11376	11376	11376	11376	11376	11376	11376	11376
				>;

			PS_Config_Lmt_Short_Diff_P = <
				6300 6300 6300 6300 6300 6300 6300 6300 6300 6300 6300 6300 6300 6300 6300 6300 6300 6300
				6300 6300 6300 6300 6300 6300 6300 6300 6300 6300 6300 6300 6300 6300 6300 6300 6300 6300
				6300 6300 6300 6300 6300 6300 6300 6300 6300 6300 6300 6300 6300 6300 6300 6300 6300 6300
				6300 6300 6300 6300 6300 6300 6300 6300 6300 6300 6300 6300 6300 6300 6300 6300 6300 6300
				6300 6300 6300 6300 6300 6300 6300 6300 6300 6300 6300 6300 6300 6300 6300 6300 6300 6300
				6300 6300 6300 6300 6300 6300 6300 6300 6300 6300 6300 6300 6300 6300 6300 6300 6300 6300
				6300 6300 6300 6300 6300 6300 6300 6300 6300 6300 6300 6300 6300 6300 6300 6300 6300 6300
				6300 6300 6300 6300 6300 6300 6300 6300 6300 6300 6300 6300 6300 6300 6300 6300 6300 6300
				6300 6300 6300 6300 6300 6300 6300 6300 6300 6300 6300 6300 6300 6300 6300 6300 6300 6300
				6300 6300 6300 6300 6300 6300 6300 6300 6300 6300 6300 6300 6300 6300 6300 6300 6300 6300
				6300 6300 6300 6300 6300 6300 6300 6300 6300 6300 6300 6300 6300 6300 6300 6300 6300 6300
				6300 6300 6300 6300 6300 6300 6300 6300 6300 6300 6300 6300 6300 6300 6300 6300 6300 6300
				6300 6300 6300 6300 6300 6300 6300 6300 6300 6300 6300 6300 6300 6300 6300 6300 6300 6300
				6300 6300 6300 6300 6300 6300 6300 6300 6300 6300 6300 6300 6300 6300 6300 6300 6300 6300
				6300 6300 6300 6300 6300 6300 6300 6300 6300 6300 6300 6300 6300 6300 6300 6300 6300 6300
				6300 6300 6300 6300 6300 6300 6300 6300 6300 6300 6300 6300 6300 6300 6300 6300 6300 6300
				6300 6300 6300 6300 6300 6300 6300 6300 6300 6300 6300 6300 6300 6300 6300 6300 6300 6300
				6300 6300 6300 6300 6300 6300 6300 6300 6300 6300 6300 6300 6300 6300 6300 6300 6300 6300
				6300 6300 6300 6300 6300 6300 6300 6300 6300 6300 6300 6300 6300 6300 6300 6300 6300 6300
				6300 6300 6300 6300 6300 6300 6300 6300 6300 6300 6300 6300 6300 6300 6300 6300 6300 6300
				6300 6300 6300 6300 6300 6300 6300 6300 6300 6300 6300 6300 6300 6300 6300 6300 6300 6300
				6300 6300 6300 6300 6300 6300 6300 6300 6300 6300 6300 6300 6300 6300 6300 6300 6300 6300
				6300 6300 6300 6300 6300 6300 6300 6300 6300 6300 6300 6300 6300 6300 6300 6300 6300 6300
				6300 6300 6300 6300 6300 6300 6300 6300 6300 6300 6300 6300 6300 6300 6300 6300 6300 6300
				6300 6300 6300 6300 6300 6300 6300 6300 6300 6300 6300 6300 6300 6300 6300 6300 6300 6300
				6300 6300 6300 6300 6300 6300 6300 6300 6300 6300 6300 6300 6300 6300 6300 6300 6300 6300
				6300 6300 6300 6300 6300 6300 6300 6300 6300 6300 6300 6300 6300 6300 6300 6300 6300 6300
				6300 6300 6300 6300 6300 6300 6300 6300 6300 6300 6300 6300 6300 6300 6300 6300 6300 6300
				6300 6300 6300 6300 6300 6300 6300 6300 6300 6300 6300 6300 6300 6300 6300 6300 6300 6300
				6300 6300 6300 6300 6300 6300 6300 6300 6300 6300 6300 6300 6300 6300 6300 6300 6300 6300
				6300 6300 6300 6300 6300 6300 6300 6300 6300 6300 6300 6300 6300 6300 6300 6300 6300 6300
				6300 6300 6300 6300 6300 6300 6300 6300 6300 6300 6300 6300 6300 6300 6300 6300 6300 6300
				6300 6300 6300>;

			PS_Config_Lmt_Short_Diff_N = <
				0 0 0 0 0 0 0 0 0 0 0 0 0 0 0 0 0 0
				0 0 0 0 0 0 0 0 0 0 0 0 0 0 0 0 0 0
				0 0 0 0 0 0 0 0 0 0 0 0 0 0 0 0 0 0
				0 0 0 0 0 0 0 0 0 0 0 0 0 0 0 0 0 0
				0 0 0 0 0 0 0 0 0 0 0 0 0 0 0 0 0 0
				0 0 0 0 0 0 0 0 0 0 0 0 0 0 0 0 0 0
				0 0 0 0 0 0 0 0 0 0 0 0 0 0 0 0 0 0
				0 0 0 0 0 0 0 0 0 0 0 0 0 0 0 0 0 0
				0 0 0 0 0 0 0 0 0 0 0 0 0 0 0 0 0 0
				0 0 0 0 0 0 0 0 0 0 0 0 0 0 0 0 0 0
				0 0 0 0 0 0 0 0 0 0 0 0 0 0 0 0 0 0
				0 0 0 0 0 0 0 0 0 0 0 0 0 0 0 0 0 0
				0 0 0 0 0 0 0 0 0 0 0 0 0 0 0 0 0 0
				0 0 0 0 0 0 0 0 0 0 0 0 0 0 0 0 0 0
				0 0 0 0 0 0 0 0 0 0 0 0 0 0 0 0 0 0
				0 0 0 0 0 0 0 0 0 0 0 0 0 0 0 0 0 0
				0 0 0 0 0 0 0 0 0 0 0 0 0 0 0 0 0 0
				0 0 0 0 0 0 0 0 0 0 0 0 0 0 0 0 0 0
				0 0 0 0 0 0 0 0 0 0 0 0 0 0 0 0 0 0
				0 0 0 0 0 0 0 0 0 0 0 0 0 0 0 0 0 0
				0 0 0 0 0 0 0 0 0 0 0 0 0 0 0 0 0 0
				0 0 0 0 0 0 0 0 0 0 0 0 0 0 0 0 0 0
				0 0 0 0 0 0 0 0 0 0 0 0 0 0 0 0 0 0
				0 0 0 0 0 0 0 0 0 0 0 0 0 0 0 0 0 0
				0 0 0 0 0 0 0 0 0 0 0 0 0 0 0 0 0 0
				0 0 0 0 0 0 0 0 0 0 0 0 0 0 0 0 0 0
				0 0 0 0 0 0 0 0 0 0 0 0 0 0 0 0 0 0
				0 0 0 0 0 0 0 0 0 0 0 0 0 0 0 0 0 0
				0 0 0 0 0 0 0 0 0 0 0 0 0 0 0 0 0 0
				0 0 0 0 0 0 0 0 0 0 0 0 0 0 0 0 0 0
				0 0 0 0 0 0 0 0 0 0 0 0 0 0 0 0 0 0
				0 0 0 0 0 0 0 0 0 0 0 0 0 0 0 0 0 0
				0 0 0>;

			PS_Config_Lmt_Short_Base_P = <
				2000 2000 2000 2000 2000 2000 2000 2000 2000 2000 2000 2000 2000 2000 2000 2000 2000 2000
				2000 2000 2000 2000 2000 2000 2000 2000 2000 2000 2000 2000 2000 2000 2000 2000 2000 2000
				2000 2000 2000 2000 2000 2000 2000 2000 2000 2000 2000 2000 2000 2000 2000 2000 2000 2000
				2000 2000 2000 2000 2000 2000 2000 2000 2000 2000 2000 2000 2000 2000 2000 2000 2000 2000
				2000 2000 2000 2000 2000 2000 2000 2000 2000 2000 2000 2000 2000 2000 2000 2000 2000 2000
				2000 2000 2000 2000 2000 2000 2000 2000 2000 2000 2000 2000 2000 2000 2000 2000 2000 2000
				2000 2000 2000 2000 2000 2000 2000 2000 2000 2000 2000 2000 2000 2000 2000 2000 2000 2000
				2000 2000 2000 2000 2000 2000 2000 2000 2000 2000 2000 2000 2000 2000 2000 2000 2000 2000
				2000 2000 2000 2000 2000 2000 2000 2000 2000 2000 2000 2000 2000 2000 2000 2000 2000 2000
				2000 2000 2000 2000 2000 2000 2000 2000 2000 2000 2000 2000 2000 2000 2000 2000 2000 2000
				2000 2000 2000 2000 2000 2000 2000 2000 2000 2000 2000 2000 2000 2000 2000 2000 2000 2000
				2000 2000 2000 2000 2000 2000 2000 2000 2000 2000 2000 2000 2000 2000 2000 2000 2000 2000
				2000 2000 2000 2000 2000 2000 2000 2000 2000 2000 2000 2000 2000 2000 2000 2000 2000 2000
				2000 2000 2000 2000 2000 2000 2000 2000 2000 2000 2000 2000 2000 2000 2000 2000 2000 2000
				2000 2000 2000 2000 2000 2000 2000 2000 2000 2000 2000 2000 2000 2000 2000 2000 2000 2000
				2000 2000 2000 2000 2000 2000 2000 2000 2000 2000 2000 2000 2000 2000 2000 2000 2000 2000
				2000 2000 2000 2000 2000 2000 2000 2000 2000 2000 2000 2000 2000 2000 2000 2000 2000 2000
				2000 2000 2000 2000 2000 2000 2000 2000 2000 2000 2000 2000 2000 2000 2000 2000 2000 2000
				2000 2000 2000 2000 2000 2000 2000 2000 2000 2000 2000 2000 2000 2000 2000 2000 2000 2000
				2000 2000 2000 2000 2000 2000 2000 2000 2000 2000 2000 2000 2000 2000 2000 2000 2000 2000
				2000 2000 2000 2000 2000 2000 2000 2000 2000 2000 2000 2000 2000 2000 2000 2000 2000 2000
				2000 2000 2000 2000 2000 2000 2000 2000 2000 2000 2000 2000 2000 2000 2000 2000 2000 2000
				2000 2000 2000 2000 2000 2000 2000 2000 2000 2000 2000 2000 2000 2000 2000 2000 2000 2000
				2000 2000 2000 2000 2000 2000 2000 2000 2000 2000 2000 2000 2000 2000 2000 2000 2000 2000
				2000 2000 2000 2000 2000 2000 2000 2000 2000 2000 2000 2000 2000 2000 2000 2000 2000 2000
				2000 2000 2000 2000 2000 2000 2000 2000 2000 2000 2000 2000 2000 2000 2000 2000 2000 2000
				2000 2000 2000 2000 2000 2000 2000 2000 2000 2000 2000 2000 2000 2000 2000 2000 2000 2000
				2000 2000 2000 2000 2000 2000 2000 2000 2000 2000 2000 2000 2000 2000 2000 2000 2000 2000
				2000 2000 2000 2000 2000 2000 2000 2000 2000 2000 2000 2000 2000 2000 2000 2000 2000 2000
				2000 2000 2000 2000 2000 2000 2000 2000 2000 2000 2000 2000 2000 2000 2000 2000 2000 2000
				2000 2000 2000 2000 2000 2000 2000 2000 2000 2000 2000 2000 2000 2000 2000 2000 2000 2000
				2000 2000 2000 2000 2000 2000 2000 2000 2000 2000 2000 2000 2000 2000 2000 2000 2000 2000
				2000 2000 2000>;

			PS_Config_Lmt_Short_Base_N = <
				(-2000) (-2000) (-2000) (-2000) (-2000) (-2000) (-2000) (-2000) (-2000) (-2000) (-2000) (-2000) (-2000) (-2000) (-2000) (-2000) (-2000) (-2000)
				(-2000) (-2000) (-2000) (-2000) (-2000) (-2000) (-2000) (-2000) (-2000) (-2000) (-2000) (-2000) (-2000) (-2000) (-2000) (-2000) (-2000) (-2000)
				(-2000) (-2000) (-2000) (-2000) (-2000) (-2000) (-2000) (-2000) (-2000) (-2000) (-2000) (-2000) (-2000) (-2000) (-2000) (-2000) (-2000) (-2000)
				(-2000) (-2000) (-2000) (-2000) (-2000) (-2000) (-2000) (-2000) (-2000) (-2000) (-2000) (-2000) (-2000) (-2000) (-2000) (-2000) (-2000) (-2000)
				(-2000) (-2000) (-2000) (-2000) (-2000) (-2000) (-2000) (-2000) (-2000) (-2000) (-2000) (-2000) (-2000) (-2000) (-2000) (-2000) (-2000) (-2000)
				(-2000) (-2000) (-2000) (-2000) (-2000) (-2000) (-2000) (-2000) (-2000) (-2000) (-2000) (-2000) (-2000) (-2000) (-2000) (-2000) (-2000) (-2000)
				(-2000) (-2000) (-2000) (-2000) (-2000) (-2000) (-2000) (-2000) (-2000) (-2000) (-2000) (-2000) (-2000) (-2000) (-2000) (-2000) (-2000) (-2000)
				(-2000) (-2000) (-2000) (-2000) (-2000) (-2000) (-2000) (-2000) (-2000) (-2000) (-2000) (-2000) (-2000) (-2000) (-2000) (-2000) (-2000) (-2000)
				(-2000) (-2000) (-2000) (-2000) (-2000) (-2000) (-2000) (-2000) (-2000) (-2000) (-2000) (-2000) (-2000) (-2000) (-2000) (-2000) (-2000) (-2000)
				(-2000) (-2000) (-2000) (-2000) (-2000) (-2000) (-2000) (-2000) (-2000) (-2000) (-2000) (-2000) (-2000) (-2000) (-2000) (-2000) (-2000) (-2000)
				(-2000) (-2000) (-2000) (-2000) (-2000) (-2000) (-2000) (-2000) (-2000) (-2000) (-2000) (-2000) (-2000) (-2000) (-2000) (-2000) (-2000) (-2000)
				(-2000) (-2000) (-2000) (-2000) (-2000) (-2000) (-2000) (-2000) (-2000) (-2000) (-2000) (-2000) (-2000) (-2000) (-2000) (-2000) (-2000) (-2000)
				(-2000) (-2000) (-2000) (-2000) (-2000) (-2000) (-2000) (-2000) (-2000) (-2000) (-2000) (-2000) (-2000) (-2000) (-2000) (-2000) (-2000) (-2000)
				(-2000) (-2000) (-2000) (-2000) (-2000) (-2000) (-2000) (-2000) (-2000) (-2000) (-2000) (-2000) (-2000) (-2000) (-2000) (-2000) (-2000) (-2000)
				(-2000) (-2000) (-2000) (-2000) (-2000) (-2000) (-2000) (-2000) (-2000) (-2000) (-2000) (-2000) (-2000) (-2000) (-2000) (-2000) (-2000) (-2000)
				(-2000) (-2000) (-2000) (-2000) (-2000) (-2000) (-2000) (-2000) (-2000) (-2000) (-2000) (-2000) (-2000) (-2000) (-2000) (-2000) (-2000) (-2000)
				(-2000) (-2000) (-2000) (-2000) (-2000) (-2000) (-2000) (-2000) (-2000) (-2000) (-2000) (-2000) (-2000) (-2000) (-2000) (-2000) (-2000) (-2000)
				(-2000) (-2000) (-2000) (-2000) (-2000) (-2000) (-2000) (-2000) (-2000) (-2000) (-2000) (-2000) (-2000) (-2000) (-2000) (-2000) (-2000) (-2000)
				(-2000) (-2000) (-2000) (-2000) (-2000) (-2000) (-2000) (-2000) (-2000) (-2000) (-2000) (-2000) (-2000) (-2000) (-2000) (-2000) (-2000) (-2000)
				(-2000) (-2000) (-2000) (-2000) (-2000) (-2000) (-2000) (-2000) (-2000) (-2000) (-2000) (-2000) (-2000) (-2000) (-2000) (-2000) (-2000) (-2000)
				(-2000) (-2000) (-2000) (-2000) (-2000) (-2000) (-2000) (-2000) (-2000) (-2000) (-2000) (-2000) (-2000) (-2000) (-2000) (-2000) (-2000) (-2000)
				(-2000) (-2000) (-2000) (-2000) (-2000) (-2000) (-2000) (-2000) (-2000) (-2000) (-2000) (-2000) (-2000) (-2000) (-2000) (-2000) (-2000) (-2000)
				(-2000) (-2000) (-2000) (-2000) (-2000) (-2000) (-2000) (-2000) (-2000) (-2000) (-2000) (-2000) (-2000) (-2000) (-2000) (-2000) (-2000) (-2000)
				(-2000) (-2000) (-2000) (-2000) (-2000) (-2000) (-2000) (-2000) (-2000) (-2000) (-2000) (-2000) (-2000) (-2000) (-2000) (-2000) (-2000) (-2000)
				(-2000) (-2000) (-2000) (-2000) (-2000) (-2000) (-2000) (-2000) (-2000) (-2000) (-2000) (-2000) (-2000) (-2000) (-2000) (-2000) (-2000) (-2000)
				(-2000) (-2000) (-2000) (-2000) (-2000) (-2000) (-2000) (-2000) (-2000) (-2000) (-2000) (-2000) (-2000) (-2000) (-2000) (-2000) (-2000) (-2000)
				(-2000) (-2000) (-2000) (-2000) (-2000) (-2000) (-2000) (-2000) (-2000) (-2000) (-2000) (-2000) (-2000) (-2000) (-2000) (-2000) (-2000) (-2000)
				(-2000) (-2000) (-2000) (-2000) (-2000) (-2000) (-2000) (-2000) (-2000) (-2000) (-2000) (-2000) (-2000) (-2000) (-2000) (-2000) (-2000) (-2000)
				(-2000) (-2000) (-2000) (-2000) (-2000) (-2000) (-2000) (-2000) (-2000) (-2000) (-2000) (-2000) (-2000) (-2000) (-2000) (-2000) (-2000) (-2000)
				(-2000) (-2000) (-2000) (-2000) (-2000) (-2000) (-2000) (-2000) (-2000) (-2000) (-2000) (-2000) (-2000) (-2000) (-2000) (-2000) (-2000) (-2000)
				(-2000) (-2000) (-2000) (-2000) (-2000) (-2000) (-2000) (-2000) (-2000) (-2000) (-2000) (-2000) (-2000) (-2000) (-2000) (-2000) (-2000) (-2000)
				(-2000) (-2000) (-2000) (-2000) (-2000) (-2000) (-2000) (-2000) (-2000) (-2000) (-2000) (-2000) (-2000) (-2000) (-2000) (-2000) (-2000) (-2000)
				(-2000) (-2000) (-2000)>;

			PS_Config_Lmt_Open_Rawdata_P = <
				2489	2496	2482	2497	2490	2499	2494	2504	2485	2482	2503	2489	2499	2485	2492	2479	2487	2464
				2478	2485	2472	2487	2482	2489	2485	2494	2475	2471	2493	2479	2489	2476	2483	2468	2478	2452
				2501	2510	2496	2511	2506	2513	2508	2518	2499	2496	2518	2503	2514	2501	2508	2494	2503	2478
				2329	2338	2494	2508	2504	2511	2506	2515	2496	2490	2513	2497	2508	2496	2504	2489	2331	2305
				2507	2514	2500	2515	2508	2515	2510	2520	2500	2499	2521	2506	2517	2504	2514	2499	2510	2486
				2511	2518	2504	2520	2514	2521	2515	2525	2506	2499	2521	2507	2517	2504	2514	2499	2510	2486
				2506	2513	2325	2342	2507	2514	2510	2520	2500	2499	2521	2507	2518	2506	2342	2328	2513	2487
				2508	2515	2504	2518	2510	2517	2513	2521	2501	2497	2521	2507	2518	2506	2517	2504	2514	2489
				2510	2520	2504	2520	2511	2518	2513	2524	2504	2499	2522	2508	2520	2506	2518	2504	2515	2490
				2511	2521	2506	2522	2339	2346	2514	2524	2504	2503	2527	2511	2349	2336	2524	2508	2521	2496
				2515	2524	2508	2525	2518	2524	2515	2525	2507	2501	2527	2511	2525	2514	2524	2510	2522	2499
				2517	2527	2511	2528	2521	2528	2518	2529	2510	2507	2531	2514	2531	2518	2528	2515	2528	2503
				2517	2527	2510	2528	2520	2527	2342	2352	2508	2504	2352	2338	2529	2515	2527	2513	2527	2501
				2518	2528	2511	2528	2520	2527	2520	2529	2508	2506	2532	2517	2529	2518	2528	2514	2527	2503
				2520	2529	2513	2529	2521	2528	2521	2532	2489	2482	2531	2515	2529	2517	2527	2513	2527	2503
				2513	2522	2506	2522	2514	2521	2514	2525	2345	2342	2527	2513	2525	2513	2524	2508	2524	2499
				2508	2518	2500	2515	2507	2514	2507	2518	2497	2501	2527	2513	2525	2514	2524	2511	2525	2500
				2508	2518	2501	2515	2507	2515	2507	2518	2497	2496	2521	2506	2520	2507	2517	2506	2520	2496
				2504	2514	2496	2510	2501	2510	2501	2513	2490	2492	2515	2501	2515	2503	2513	2501	2515	2492
				2497	2507	2489	2503	2493	2501	2493	2504	2482	2483	2508	2493	2507	2494	2506	2494	2510	2485
				2490	2501	2482	2497	2486	2494	2486	2497	2473	2475	2500	2485	2500	2486	2497	2486	2500	2475
				2487	2497	2478	2493	2482	2490	2480	2493	2469	2472	2497	2482	2497	2483	2496	2483	2499	2473
				2480	2492	2472	2486	2475	2485	2475	2487	2462	2466	2493	2478	2493	2479	2492	2479	2494	2469
				2482	2493	2472	2487	2475	2485	2473	2487	2461	2465	2492	2476	2492	2478	2492	2478	2494	2468
				2479	2492	2471	2486	2473	2483	2472	2486	2459	2464	2490	2473	2490	2476	2489	2476	2493	2466
				2480	2492	2471	2486	2472	2483	2472	2486	2459	2461	2489	2471	2487	2473	2487	2473	2492	2464
				2476	2489	2466	2482	2468	2479	2466	2482	2454	2457	2485	2466	2485	2469	2485	2471	2489	2459
				2471	2485	2462	2479	2464	2475	2462	2478	2450	2452	2479	2462	2480	2465	2480	2465	2483	2455
				2466	2480	2458	2473	2458	2471	2457	2472	2443	2445	2473	2455	2473	2457	2473	2458	2476	2447
				2473	2489	2466	2483	2468	2480	2466	2482	2454	2457	2486	2466	2485	2468	2485	2468	2486	2457
				2451	2466	2445	2464	2447	2461	2445	2462	2433	2436	2465	2445	2465	2447	2465	2447	2464	2433
				2468	2485	2465	2483	2466	2480	2465	2479	2448	2451	2482	2464	2485	2464	2485	2464	2480	2448
				>;

			PS_Config_Lmt_Open_Rawdata_N = <
				1066	1069	1063	1070	1067	1071	1069	1073	1065	1063	1072	1066	1071	1065	1068	1062	1066	1056
				1062	1065	1059	1066	1063	1066	1065	1069	1060	1059	1068	1062	1066	1061	1064	1057	1062	1051
				1072	1075	1069	1076	1074	1077	1075	1079	1071	1069	1079	1072	1077	1072	1075	1069	1072	1062
				998	1002	1069	1075	1073	1076	1074	1078	1069	1067	1077	1070	1075	1069	1073	1066	999	988
				1074	1077	1071	1078	1075	1078	1075	1080	1071	1071	1080	1074	1078	1073	1077	1071	1075	1065
				1076	1079	1073	1080	1077	1080	1078	1082	1074	1071	1080	1074	1078	1073	1077	1071	1075	1065
				1074	1077	996	1003	1074	1077	1075	1080	1071	1071	1080	1074	1079	1074	1003	997	1077	1066
				1075	1078	1073	1079	1075	1078	1077	1080	1072	1070	1080	1074	1079	1074	1078	1073	1077	1066
				1075	1080	1073	1080	1076	1079	1077	1081	1073	1071	1081	1075	1080	1074	1079	1073	1078	1067
				1076	1080	1074	1081	1002	1005	1077	1081	1073	1072	1083	1076	1006	1001	1081	1075	1080	1069
				1078	1081	1075	1082	1079	1081	1078	1082	1074	1072	1083	1076	1082	1077	1081	1075	1081	1071
				1078	1083	1076	1083	1080	1083	1079	1084	1075	1074	1084	1077	1084	1079	1083	1078	1083	1072
				1078	1083	1075	1083	1080	1083	1003	1008	1075	1073	1008	1002	1084	1078	1083	1077	1083	1072
				1079	1083	1076	1083	1080	1083	1080	1084	1075	1074	1085	1078	1084	1079	1083	1077	1083	1072
				1080	1084	1077	1084	1080	1083	1080	1085	1066	1063	1084	1078	1084	1078	1083	1077	1083	1072
				1077	1081	1074	1081	1077	1080	1077	1082	1005	1003	1083	1077	1082	1077	1081	1075	1081	1071
				1075	1079	1071	1078	1074	1077	1074	1079	1070	1072	1083	1077	1082	1077	1081	1076	1082	1071
				1075	1079	1072	1078	1074	1078	1074	1079	1070	1069	1080	1074	1080	1074	1078	1074	1080	1069
				1073	1077	1069	1075	1072	1075	1072	1077	1067	1068	1078	1072	1078	1072	1077	1072	1078	1068
				1070	1074	1066	1072	1068	1072	1068	1073	1063	1064	1075	1068	1074	1069	1074	1069	1075	1065
				1067	1072	1063	1070	1065	1069	1065	1070	1060	1060	1071	1065	1071	1065	1070	1065	1071	1060
				1066	1070	1062	1068	1063	1067	1063	1068	1058	1059	1070	1063	1070	1064	1069	1064	1071	1060
				1063	1068	1059	1065	1060	1065	1060	1066	1055	1057	1068	1062	1068	1062	1068	1062	1069	1058
				1063	1068	1059	1066	1060	1065	1060	1066	1054	1056	1068	1061	1068	1062	1068	1062	1069	1057
				1062	1068	1059	1065	1060	1064	1059	1065	1054	1056	1067	1060	1067	1061	1066	1061	1068	1057
				1063	1068	1059	1065	1059	1064	1059	1065	1054	1054	1066	1059	1066	1060	1066	1060	1068	1056
				1061	1066	1057	1063	1057	1062	1057	1063	1051	1053	1065	1057	1065	1058	1065	1059	1066	1054
				1059	1065	1055	1062	1056	1060	1055	1062	1050	1051	1062	1055	1063	1056	1063	1056	1064	1052
				1057	1063	1053	1060	1053	1059	1053	1059	1047	1048	1060	1052	1060	1053	1060	1053	1061	1048
				1060	1066	1057	1064	1057	1063	1057	1063	1051	1053	1065	1057	1065	1057	1065	1057	1065	1053
				1050	1057	1048	1056	1048	1054	1048	1055	1042	1044	1056	1048	1056	1048	1056	1048	1056	1042
				1057	1065	1056	1064	1057	1063	1056	1062	1049	1050	1063	1056	1065	1056	1065	1056	1063	1049
				>;

			PS_Config_Lmt_FW_Rawdata_P = <
				838	837	841	837	841	838	842	837	841	847	842	844	847	845	841	845	844	847
				833	833	837	833	838	835	838	833	837	842	837	841	841	844	837	840	840	842
				834	833	837	833	841	840	840	833	838	844	844	838	842	841	842	841	844	845
				830	834	833	834	833	833	833	834	834	837	842	838	838	835	841	840	842	844
				835	834	838	835	835	833	838	833	838	841	838	840	841	841	840	841	838	844
				837	835	837	835	834	831	835	835	835	841	841	838	837	837	840	842	841	845
				833	838	833	833	834	834	833	834	831	837	840	835	838	837	838	838	842	842
				831	835	834	834	833	833	831	831	831	835	840	840	840	840	841	838	845	845
				831	831	835	834	835	830	834	835	835	840	840	840	840	840	840	842	840	844
				837	837	837	837	835	831	837	834	835	842	838	844	837	840	842	842	840	844
				830	834	831	833	831	833	831	833	831	837	838	838	840	838	841	838	840	841
				830	833	833	831	834	834	834	833	831	838	840	838	838	837	838	838	838	845
				834	835	837	835	837	837	834	831	834	841	841	844	841	842	842	845	838	845
				834	833	838	835	835	833	837	831	835	844	840	844	838	841	841	842	841	847
				833	834	834	835	834	834	834	831	833	840	841	841	841	841	842	842	838	844
				831	834	834	833	833	831	834	835	833	842	847	840	837	838	837	838	844	848
				834	834	840	831	840	833	834	834	837	844	841	845	840	844	842	845	838	847
				834	835	835	833	837	835	838	831	835	845	840	844	842	847	841	844	841	847
				830	833	834	834	834	831	833	835	833	844	837	845	840	842	841	841	840	844
				830	834	833	833	835	834	835	833	834	845	841	844	840	844	840	844	838	842
				831	831	833	834	834	831	837	833	838	845	840	847	840	844	842	841	840	848
				833	834	835	833	838	834	835	831	835	847	840	845	841	847	842	844	840	845
				830	833	833	830	834	831	831	834	833	844	838	844	838	842	840	842	837	844
				830	833	833	834	835	833	835	833	833	847	840	844	838	841	841	842	840	847
				834	831	838	835	837	834	838	830	835	844	837	845	841	848	842	844	835	844
				831	834	835	831	835	835	837	833	835	845	840	844	838	845	837	845	840	848
				828	828	831	831	833	835	834	833	833	845	838	844	842	844	837	844	840	848
				830	830	833	831	833	833	834	833	835	845	840	844	840	844	838	842	838	848
				833	831	834	830	834	831	834	833	835	848	837	844	840	845	838	845	837	848
				835	833	838	837	835	833	837	838	834	848	848	852	842	849	844	851	842	854
				828	830	833	831	834	831	835	834	830	847	838	845	838	845	837	847	837	847
				834	834	834	833	833	831	837	831	834	847	841	848	840	849	842	848	842	849
				>;

			PS_Config_Lmt_FW_Rawdata_N = <
				359	358	360	358	360	359	361	358	360	363	361	361	363	362	360	362	361	363
				357	357	358	357	359	358	359	357	358	361	358	360	360	361	358	360	360	361
				357	357	358	357	360	360	360	357	359	361	361	359	361	360	361	360	361	362
				355	357	357	357	357	357	357	357	357	358	361	359	359	358	360	360	361	361
				358	357	359	358	358	357	359	357	359	360	359	360	360	360	360	360	359	361
				358	358	358	358	357	356	358	358	358	360	360	359	358	358	360	361	360	362
				357	359	357	357	357	357	357	357	356	358	360	358	359	358	359	359	361	361
				356	358	357	357	357	357	356	356	356	358	360	360	360	360	360	359	362	362
				356	356	358	357	358	355	357	358	358	360	360	360	360	360	360	361	360	361
				358	358	358	358	358	356	358	357	358	361	359	361	358	360	361	361	360	361
				355	357	356	357	356	357	356	357	356	358	359	359	360	359	360	359	360	360
				355	357	357	356	357	357	357	357	356	359	360	359	359	358	359	359	359	362
				357	358	358	358	358	358	357	356	357	360	360	361	360	361	361	362	359	362
				357	357	359	358	358	357	358	356	358	361	360	361	359	360	360	361	360	363
				357	357	357	358	357	357	357	356	357	360	360	360	360	360	361	361	359	361
				356	357	357	357	357	356	357	358	357	361	363	360	358	359	358	359	361	363
				357	357	360	356	360	357	357	357	358	361	360	362	360	361	361	362	359	363
				357	358	358	357	358	358	359	356	358	362	360	361	361	363	360	361	360	363
				355	357	357	357	357	356	357	358	357	361	358	362	360	361	360	360	360	361
				355	357	357	357	358	357	358	357	357	362	360	361	360	361	360	361	359	361
				356	356	357	357	357	356	358	357	359	362	360	363	360	361	361	360	360	363
				357	357	358	357	359	357	358	356	358	363	360	362	360	363	361	361	360	362
				355	357	357	355	357	356	356	357	357	361	359	361	359	361	360	361	358	361
				355	357	357	357	358	357	358	357	357	363	360	361	359	360	360	361	360	363
				357	356	359	358	358	357	359	355	358	361	358	362	360	363	361	361	358	361
				356	357	358	356	358	358	358	357	358	362	360	361	359	362	358	362	360	363
				355	355	356	356	357	358	357	357	357	362	359	361	361	361	358	361	360	363
				355	355	357	356	357	357	357	357	358	362	360	361	360	361	359	361	359	363
				357	356	357	355	357	356	357	357	358	363	358	361	360	362	359	362	358	363
				358	357	359	358	358	357	358	359	357	363	363	365	361	364	361	364	361	366
				355	355	357	356	357	356	358	357	355	363	359	362	359	362	358	363	358	363
				357	357	357	357	357	356	358	356	357	363	360	363	360	364	361	363	361	364
				>;

			PS_Config_Lmt_FW_CC_P = <
				143	142	142	142	142	142	143	143	144	144	142	142	142	142	140	140	140	142
				146	144	144	144	146	146	146	146	149	149	147	147	147	146	146	146	146	147
				142	140	140	140	142	142	142	142	144	144	142	142	142	142	140	140	142	142
				146	144	144	144	146	146	146	146	149	150	147	147	147	147	146	146	146	147
				147	146	146	146	147	147	147	147	150	150	147	147	147	147	146	147	147	147
				147	146	146	146	147	147	147	147	150	151	149	149	149	149	147	147	147	149
				147	146	146	146	147	147	147	147	150	151	149	149	149	149	147	147	147	149
				147	146	146	146	147	147	147	149	150	151	150	149	149	149	147	149	147	149
				147	146	147	147	147	147	149	149	151	151	150	149	149	149	147	149	147	149
				149	147	147	147	149	149	149	149	151	153	150	150	150	150	149	149	149	150
				147	146	147	147	147	147	149	149	151	153	150	150	149	149	149	149	147	149
				149	147	147	147	149	149	149	149	151	153	150	150	150	150	149	149	149	150
				149	147	149	149	149	149	149	150	153	153	151	150	150	150	149	149	149	150
				150	149	149	149	150	150	150	150	153	154	151	151	151	151	150	150	150	151
				149	147	149	149	149	149	150	150	153	154	151	151	151	151	150	150	150	150
				150	149	149	149	150	150	150	150	153	155	153	151	151	151	150	150	150	151
				150	149	149	149	150	150	150	151	154	155	153	151	151	151	150	150	150	151
				150	149	150	150	150	151	151	151	154	155	153	153	153	153	151	151	150	151
				150	149	149	149	150	150	150	151	154	155	153	151	151	151	150	150	150	151
				150	149	149	149	150	150	150	151	154	155	153	153	151	151	150	150	150	151
				150	149	149	150	150	151	151	151	154	155	153	153	151	151	151	150	150	151
				151	150	150	150	151	151	151	151	154	155	154	153	153	153	151	151	150	151
				150	149	149	150	150	150	150	151	154	155	153	153	151	151	150	150	150	151
				151	149	150	150	151	151	151	151	154	155	153	153	153	151	151	150	150	151
				151	150	150	150	151	151	151	153	155	157	154	154	153	153	151	151	151	153
				153	150	151	151	153	153	153	153	155	157	154	154	154	154	153	151	151	153
				151	150	150	150	151	151	151	151	154	155	154	153	153	153	151	151	151	153
				151	150	150	150	151	151	151	151	154	155	154	153	153	153	151	151	151	153
				153	150	150	151	151	151	151	153	155	155	154	154	153	153	153	151	151	153
				149	147	147	147	149	149	149	149	151	151	149	149	149	149	147	147	147	149
				153	150	150	150	151	151	151	151	154	155	153	153	153	153	151	151	151	153
				149	146	146	147	147	147	147	147	151	150	147	147	147	147	146	146	147	149
				>;

			PS_Config_Lmt_FW_CC_N = <
				64	63	63	63	63	63	64	64	65	65	63	63	63	63	63	63	63	63
				65	65	65	65	65	65	65	65	66	66	66	66	66	65	65	65	65	66
				63	63	63	63	63	63	63	63	65	65	63	63	63	63	63	63	63	63
				65	65	65	65	65	65	65	65	66	67	66	66	66	66	65	65	65	66
				66	65	65	65	66	66	66	66	67	67	66	66	66	66	65	66	66	66
				66	65	65	65	66	66	66	66	67	68	66	66	66	66	66	66	66	66
				66	65	65	65	66	66	66	66	67	68	66	66	66	66	66	66	66	66
				66	65	65	65	66	66	66	66	67	68	67	66	66	66	66	66	66	66
				66	65	66	66	66	66	66	66	68	68	67	66	66	66	66	66	66	66
				66	66	66	66	66	66	66	66	68	68	67	67	67	67	66	66	66	67
				66	65	66	66	66	66	66	66	68	68	67	67	66	66	66	66	66	66
				66	66	66	66	66	66	66	66	68	68	67	67	67	67	66	66	66	67
				66	66	66	66	66	66	66	67	68	68	68	67	67	67	66	66	66	67
				67	66	66	66	67	67	67	67	68	69	68	68	68	68	67	67	67	68
				66	66	66	66	66	66	67	67	68	69	68	68	68	68	67	67	67	67
				67	66	66	66	67	67	67	67	68	70	68	68	68	68	67	67	67	68
				67	66	66	66	67	67	67	68	69	70	68	68	68	68	67	67	67	68
				67	66	67	67	67	68	68	68	69	70	68	68	68	68	68	68	67	68
				67	66	66	66	67	67	67	68	69	70	68	68	68	68	67	67	67	68
				67	66	66	66	67	67	67	68	69	70	68	68	68	68	67	67	67	68
				67	66	66	67	67	68	68	68	69	70	68	68	68	68	68	67	67	68
				68	67	67	67	68	68	68	68	69	70	69	68	68	68	68	68	67	68
				67	66	66	67	67	67	67	68	69	70	68	68	68	68	67	67	67	68
				68	66	67	67	68	68	68	68	69	70	68	68	68	68	68	67	67	68
				68	67	67	67	68	68	68	68	70	70	69	69	68	68	68	68	68	68
				68	67	68	68	68	68	68	68	70	70	69	69	69	69	68	68	68	68
				68	67	67	67	68	68	68	68	69	70	69	68	68	68	68	68	68	68
				68	67	67	67	68	68	68	68	69	70	69	68	68	68	68	68	68	68
				68	67	67	68	68	68	68	68	70	70	69	69	68	68	68	68	68	68
				66	66	66	66	66	66	66	66	68	68	66	66	66	66	66	66	66	66
				68	67	67	67	68	68	68	68	69	70	68	68	68	68	68	68	68	68
				66	65	65	66	66	66	66	66	68	67	66	66	66	66	65	65	66	66
				>;

			PS_Config_Lmt_FW_CC_I_P = <
				25 25 25 25 25 25 25 25 25 25 25 25 25 25 25 25 25 25
				25 25 25 25 25 25 25 25 25 25 25 25 25 25 25 25 25 25
				25 25 25 25 25 25 25 25 25 25 25 25 25 25 25 25 25 25
				25 25 25 25 25 25 25 25 25 25 25 25 25 25 25 25 25 25
				25 25 25 25 25 25 25 25 25 25 25 25 25 25 25 25 25 25
				25 25 25 25 25 25 25 25 25 25 25 25 25 25 25 25 25 25
				25 25 25 25 25 25 25 25 25 25 25 25 25 25 25 25 25 25
				25 25 25 25 25 25 25 25 25 25 25 25 25 25 25 25 25 25
				25 25 25 25 25 25 25 25 25 25 25 25 25 25 25 25 25 25
				25 25 25 25 25 25 25 25 25 25 25 25 25 25 25 25 25 25
				25 25 25 25 25 25 25 25 25 25 25 25 25 25 25 25 25 25
				25 25 25 25 25 25 25 25 25 25 25 25 25 25 25 25 25 25
				25 25 25 25 25 25 25 25 25 25 25 25 25 25 25 25 25 25
				25 25 25 25 25 25 25 25 25 25 25 25 25 25 25 25 25 25
				25 25 25 25 25 25 25 25 25 25 25 25 25 25 25 25 25 25
				25 25 25 25 25 25 25 25 25 25 25 25 25 25 25 25 25 25
				25 25 25 25 25 25 25 25 25 25 25 25 25 25 25 25 25 25
				25 25 25 25 25 25 25 25 25 25 25 25 25 25 25 25 25 25
				25 25 25 25 25 25 25 25 25 25 25 25 25 25 25 25 25 25
				25 25 25 25 25 25 25 25 25 25 25 25 25 25 25 25 25 25
				25 25 25 25 25 25 25 25 25 25 25 25 25 25 25 25 25 25
				25 25 25 25 25 25 25 25 25 25 25 25 25 25 25 25 25 25
				25 25 25 25 25 25 25 25 25 25 25 25 25 25 25 25 25 25
				25 25 25 25 25 25 25 25 25 25 25 25 25 25 25 25 25 25
				25 25 25 25 25 25 25 25 25 25 25 25 25 25 25 25 25 25
				25 25 25 25 25 25 25 25 25 25 25 25 25 25 25 25 25 25
				25 25 25 25 25 25 25 25 25 25 25 25 25 25 25 25 25 25
				25 25 25 25 25 25 25 25 25 25 25 25 25 25 25 25 25 25
				25 25 25 25 25 25 25 25 25 25 25 25 25 25 25 25 25 25
				25 25 25 25 25 25 25 25 25 25 25 25 25 25 25 25 25 25
				25 25 25 25 25 25 25 25 25 25 25 25 25 25 25 25 25 25
				25 25 25 25 25 25 25 25 25 25 25 25 25 25 25 25 25 25
				25 25 25>;

			PS_Config_Lmt_FW_CC_I_N = <
				0 0 0 0 0 0 0 0 0 0 0 0 0 0 0 0 0 0
				0 0 0 0 0 0 0 0 0 0 0 0 0 0 0 0 0 0
				0 0 0 0 0 0 0 0 0 0 0 0 0 0 0 0 0 0
				0 0 0 0 0 0 0 0 0 0 0 0 0 0 0 0 0 0
				0 0 0 0 0 0 0 0 0 0 0 0 0 0 0 0 0 0
				0 0 0 0 0 0 0 0 0 0 0 0 0 0 0 0 0 0
				0 0 0 0 0 0 0 0 0 0 0 0 0 0 0 0 0 0
				0 0 0 0 0 0 0 0 0 0 0 0 0 0 0 0 0 0
				0 0 0 0 0 0 0 0 0 0 0 0 0 0 0 0 0 0
				0 0 0 0 0 0 0 0 0 0 0 0 0 0 0 0 0 0
				0 0 0 0 0 0 0 0 0 0 0 0 0 0 0 0 0 0
				0 0 0 0 0 0 0 0 0 0 0 0 0 0 0 0 0 0
				0 0 0 0 0 0 0 0 0 0 0 0 0 0 0 0 0 0
				0 0 0 0 0 0 0 0 0 0 0 0 0 0 0 0 0 0
				0 0 0 0 0 0 0 0 0 0 0 0 0 0 0 0 0 0
				0 0 0 0 0 0 0 0 0 0 0 0 0 0 0 0 0 0
				0 0 0 0 0 0 0 0 0 0 0 0 0 0 0 0 0 0
				0 0 0 0 0 0 0 0 0 0 0 0 0 0 0 0 0 0
				0 0 0 0 0 0 0 0 0 0 0 0 0 0 0 0 0 0
				0 0 0 0 0 0 0 0 0 0 0 0 0 0 0 0 0 0
				0 0 0 0 0 0 0 0 0 0 0 0 0 0 0 0 0 0
				0 0 0 0 0 0 0 0 0 0 0 0 0 0 0 0 0 0
				0 0 0 0 0 0 0 0 0 0 0 0 0 0 0 0 0 0
				0 0 0 0 0 0 0 0 0 0 0 0 0 0 0 0 0 0
				0 0 0 0 0 0 0 0 0 0 0 0 0 0 0 0 0 0
				0 0 0 0 0 0 0 0 0 0 0 0 0 0 0 0 0 0
				0 0 0 0 0 0 0 0 0 0 0 0 0 0 0 0 0 0
				0 0 0 0 0 0 0 0 0 0 0 0 0 0 0 0 0 0
				0 0 0 0 0 0 0 0 0 0 0 0 0 0 0 0 0 0
				0 0 0 0 0 0 0 0 0 0 0 0 0 0 0 0 0 0
				0 0 0 0 0 0 0 0 0 0 0 0 0 0 0 0 0 0
				0 0 0 0 0 0 0 0 0 0 0 0 0 0 0 0 0 0
				0 0 0>;

			PS_Config_Lmt_FW_CC_Q_P = <
				25 25 25 25 25 25 25 25 25 25 25 25 25 25 25 25 25 25
				25 25 25 25 25 25 25 25 25 25 25 25 25 25 25 25 25 25
				25 25 25 25 25 25 25 25 25 25 25 25 25 25 25 25 25 25
				25 25 25 25 25 25 25 25 25 25 25 25 25 25 25 25 25 25
				25 25 25 25 25 25 25 25 25 25 25 25 25 25 25 25 25 25
				25 25 25 25 25 25 25 25 25 25 25 25 25 25 25 25 25 25
				25 25 25 25 25 25 25 25 25 25 25 25 25 25 25 25 25 25
				25 25 25 25 25 25 25 25 25 25 25 25 25 25 25 25 25 25
				25 25 25 25 25 25 25 25 25 25 25 25 25 25 25 25 25 25
				25 25 25 25 25 25 25 25 25 25 25 25 25 25 25 25 25 25
				25 25 25 25 25 25 25 25 25 25 25 25 25 25 25 25 25 25
				25 25 25 25 25 25 25 25 25 25 25 25 25 25 25 25 25 25
				25 25 25 25 25 25 25 25 25 25 25 25 25 25 25 25 25 25
				25 25 25 25 25 25 25 25 25 25 25 25 25 25 25 25 25 25
				25 25 25 25 25 25 25 25 25 25 25 25 25 25 25 25 25 25
				25 25 25 25 25 25 25 25 25 25 25 25 25 25 25 25 25 25
				25 25 25 25 25 25 25 25 25 25 25 25 25 25 25 25 25 25
				25 25 25 25 25 25 25 25 25 25 25 25 25 25 25 25 25 25
				25 25 25 25 25 25 25 25 25 25 25 25 25 25 25 25 25 25
				25 25 25 25 25 25 25 25 25 25 25 25 25 25 25 25 25 25
				25 25 25 25 25 25 25 25 25 25 25 25 25 25 25 25 25 25
				25 25 25 25 25 25 25 25 25 25 25 25 25 25 25 25 25 25
				25 25 25 25 25 25 25 25 25 25 25 25 25 25 25 25 25 25
				25 25 25 25 25 25 25 25 25 25 25 25 25 25 25 25 25 25
				25 25 25 25 25 25 25 25 25 25 25 25 25 25 25 25 25 25
				25 25 25 25 25 25 25 25 25 25 25 25 25 25 25 25 25 25
				25 25 25 25 25 25 25 25 25 25 25 25 25 25 25 25 25 25
				25 25 25 25 25 25 25 25 25 25 25 25 25 25 25 25 25 25
				25 25 25 25 25 25 25 25 25 25 25 25 25 25 25 25 25 25
				25 25 25 25 25 25 25 25 25 25 25 25 25 25 25 25 25 25
				25 25 25 25 25 25 25 25 25 25 25 25 25 25 25 25 25 25
				25 25 25 25 25 25 25 25 25 25 25 25 25 25 25 25 25 25
				25 25 25>;

			PS_Config_Lmt_FW_CC_Q_N = <
				0 0 0 0 0 0 0 0 0 0 0 0 0 0 0 0 0 0
				0 0 0 0 0 0 0 0 0 0 0 0 0 0 0 0 0 0
				0 0 0 0 0 0 0 0 0 0 0 0 0 0 0 0 0 0
				0 0 0 0 0 0 0 0 0 0 0 0 0 0 0 0 0 0
				0 0 0 0 0 0 0 0 0 0 0 0 0 0 0 0 0 0
				0 0 0 0 0 0 0 0 0 0 0 0 0 0 0 0 0 0
				0 0 0 0 0 0 0 0 0 0 0 0 0 0 0 0 0 0
				0 0 0 0 0 0 0 0 0 0 0 0 0 0 0 0 0 0
				0 0 0 0 0 0 0 0 0 0 0 0 0 0 0 0 0 0
				0 0 0 0 0 0 0 0 0 0 0 0 0 0 0 0 0 0
				0 0 0 0 0 0 0 0 0 0 0 0 0 0 0 0 0 0
				0 0 0 0 0 0 0 0 0 0 0 0 0 0 0 0 0 0
				0 0 0 0 0 0 0 0 0 0 0 0 0 0 0 0 0 0
				0 0 0 0 0 0 0 0 0 0 0 0 0 0 0 0 0 0
				0 0 0 0 0 0 0 0 0 0 0 0 0 0 0 0 0 0
				0 0 0 0 0 0 0 0 0 0 0 0 0 0 0 0 0 0
				0 0 0 0 0 0 0 0 0 0 0 0 0 0 0 0 0 0
				0 0 0 0 0 0 0 0 0 0 0 0 0 0 0 0 0 0
				0 0 0 0 0 0 0 0 0 0 0 0 0 0 0 0 0 0
				0 0 0 0 0 0 0 0 0 0 0 0 0 0 0 0 0 0
				0 0 0 0 0 0 0 0 0 0 0 0 0 0 0 0 0 0
				0 0 0 0 0 0 0 0 0 0 0 0 0 0 0 0 0 0
				0 0 0 0 0 0 0 0 0 0 0 0 0 0 0 0 0 0
				0 0 0 0 0 0 0 0 0 0 0 0 0 0 0 0 0 0
				0 0 0 0 0 0 0 0 0 0 0 0 0 0 0 0 0 0
				0 0 0 0 0 0 0 0 0 0 0 0 0 0 0 0 0 0
				0 0 0 0 0 0 0 0 0 0 0 0 0 0 0 0 0 0
				0 0 0 0 0 0 0 0 0 0 0 0 0 0 0 0 0 0
				0 0 0 0 0 0 0 0 0 0 0 0 0 0 0 0 0 0
				0 0 0 0 0 0 0 0 0 0 0 0 0 0 0 0 0 0
				0 0 0 0 0 0 0 0 0 0 0 0 0 0 0 0 0 0
				0 0 0 0 0 0 0 0 0 0 0 0 0 0 0 0 0 0
				0 0 0>;

			PS_Config_Lmt_FW_Diff_P = <
				50	50	50	50	50	50	50	50	50	50	50	50	50	50	50	50	50	50
				50	50	50	50	50	50	50	50	50	50	50	50	50	50	50	50	50	50
				50	50	50	50	50	50	50	50	50	50	50	50	50	50	50	50	50	50
				50	50	50	50	50	50	50	50	50	50	50	50	50	50	50	50	50	50
				50	50	50	50	50	50	50	50	50	50	50	50	50	50	50	50	50	50
				50	50	50	50	50	50	50	50	50	50	50	50	50	50	50	50	50	50
				50	50	50	50	50	50	50	50	50	50	50	50	50	50	50	50	50	50
				50	50	50	50	50	50	50	50	50	50	50	50	50	50	50	50	50	50
				50	50	50	50	50	50	50	50	50	50	50	50	50	50	50	50	50	50
				50	50	50	50	50	50	50	50	50	50	50	50	50	50	50	50	50	50
				50	50	50	50	50	50	50	50	50	50	50	50	50	50	50	50	50	50
				50	50	50	50	50	50	50	50	50	50	50	50	50	50	50	50	50	50
				50	50	50	50	50	50	50	50	50	50	50	50	50	50	50	50	50	50
				50	50	50	50	50	50	50	50	50	50	50	50	50	50	50	50	50	50
				50	50	50	50	50	50	50	50	50	50	50	50	50	50	50	50	50	50
				50	50	50	50	50	50	50	50	50	50	50	50	50	50	50	50	50	50
				50	50	50	50	50	50	50	50	50	50	50	50	50	50	50	50	50	50
				50	50	50	50	50	50	50	50	50	50	50	50	50	50	50	50	50	50
				50	50	50	50	50	50	50	50	50	50	50	50	50	50	50	50	50	50
				50	50	50	50	50	50	50	50	50	50	50	50	50	50	50	50	50	50
				50	50	50	50	50	50	50	50	50	50	50	50	50	50	50	50	50	50
				50	50	50	50	50	50	50	50	50	50	50	50	50	50	50	50	50	50
				50	50	50	50	50	50	50	50	50	50	50	50	50	50	50	50	50	50
				50	50	50	50	50	50	50	50	50	50	50	50	50	50	50	50	50	50
				50	50	50	50	50	50	50	50	50	50	50	50	50	50	50	50	50	50
				50	50	50	50	50	50	50	50	50	50	50	50	50	50	50	50	50	50
				50	50	50	50	50	50	50	50	50	50	50	50	50	50	50	50	50	50
				50	50	50	50	50	50	50	50	50	50	50	50	50	50	50	50	50	50
				50	50	50	50	50	50	50	50	50	50	50	50	50	50	50	50	50	50
				50	50	50	50	50	50	50	50	50	50	50	50	50	50	50	50	50	50
				50	50	50	50	50	50	50	50	50	50	50	50	50	50	50	50	50	50
				50	50	50	50	50	50	50	50	50	50	50	50	50	50	50	50	50	50
				>;

			PS_Config_Lmt_FW_Diff_N = <
				(-50)	(-50)	(-50)	(-50)	(-50)	(-50)	(-50)	(-50)	(-50)	(-50)	(-50)	(-50)	(-50)	(-50)	(-50)	(-50)	(-50)	(-50)
				(-50)	(-50)	(-50)	(-50)	(-50)	(-50)	(-50)	(-50)	(-50)	(-50)	(-50)	(-50)	(-50)	(-50)	(-50)	(-50)	(-50)	(-50)
				(-50)	(-50)	(-50)	(-50)	(-50)	(-50)	(-50)	(-50)	(-50)	(-50)	(-50)	(-50)	(-50)	(-50)	(-50)	(-50)	(-50)	(-50)
				(-50)	(-50)	(-50)	(-50)	(-50)	(-50)	(-50)	(-50)	(-50)	(-50)	(-50)	(-50)	(-50)	(-50)	(-50)	(-50)	(-50)	(-50)
				(-50)	(-50)	(-50)	(-50)	(-50)	(-50)	(-50)	(-50)	(-50)	(-50)	(-50)	(-50)	(-50)	(-50)	(-50)	(-50)	(-50)	(-50)
				(-50)	(-50)	(-50)	(-50)	(-50)	(-50)	(-50)	(-50)	(-50)	(-50)	(-50)	(-50)	(-50)	(-50)	(-50)	(-50)	(-50)	(-50)
				(-50)	(-50)	(-50)	(-50)	(-50)	(-50)	(-50)	(-50)	(-50)	(-50)	(-50)	(-50)	(-50)	(-50)	(-50)	(-50)	(-50)	(-50)
				(-50)	(-50)	(-50)	(-50)	(-50)	(-50)	(-50)	(-50)	(-50)	(-50)	(-50)	(-50)	(-50)	(-50)	(-50)	(-50)	(-50)	(-50)
				(-50)	(-50)	(-50)	(-50)	(-50)	(-50)	(-50)	(-50)	(-50)	(-50)	(-50)	(-50)	(-50)	(-50)	(-50)	(-50)	(-50)	(-50)
				(-50)	(-50)	(-50)	(-50)	(-50)	(-50)	(-50)	(-50)	(-50)	(-50)	(-50)	(-50)	(-50)	(-50)	(-50)	(-50)	(-50)	(-50)
				(-50)	(-50)	(-50)	(-50)	(-50)	(-50)	(-50)	(-50)	(-50)	(-50)	(-50)	(-50)	(-50)	(-50)	(-50)	(-50)	(-50)	(-50)
				(-50)	(-50)	(-50)	(-50)	(-50)	(-50)	(-50)	(-50)	(-50)	(-50)	(-50)	(-50)	(-50)	(-50)	(-50)	(-50)	(-50)	(-50)
				(-50)	(-50)	(-50)	(-50)	(-50)	(-50)	(-50)	(-50)	(-50)	(-50)	(-50)	(-50)	(-50)	(-50)	(-50)	(-50)	(-50)	(-50)
				(-50)	(-50)	(-50)	(-50)	(-50)	(-50)	(-50)	(-50)	(-50)	(-50)	(-50)	(-50)	(-50)	(-50)	(-50)	(-50)	(-50)	(-50)
				(-50)	(-50)	(-50)	(-50)	(-50)	(-50)	(-50)	(-50)	(-50)	(-50)	(-50)	(-50)	(-50)	(-50)	(-50)	(-50)	(-50)	(-50)
				(-50)	(-50)	(-50)	(-50)	(-50)	(-50)	(-50)	(-50)	(-50)	(-50)	(-50)	(-50)	(-50)	(-50)	(-50)	(-50)	(-50)	(-50)
				(-50)	(-50)	(-50)	(-50)	(-50)	(-50)	(-50)	(-50)	(-50)	(-50)	(-50)	(-50)	(-50)	(-50)	(-50)	(-50)	(-50)	(-50)
				(-50)	(-50)	(-50)	(-50)	(-50)	(-50)	(-50)	(-50)	(-50)	(-50)	(-50)	(-50)	(-50)	(-50)	(-50)	(-50)	(-50)	(-50)
				(-50)	(-50)	(-50)	(-50)	(-50)	(-50)	(-50)	(-50)	(-50)	(-50)	(-50)	(-50)	(-50)	(-50)	(-50)	(-50)	(-50)	(-50)
				(-50)	(-50)	(-50)	(-50)	(-50)	(-50)	(-50)	(-50)	(-50)	(-50)	(-50)	(-50)	(-50)	(-50)	(-50)	(-50)	(-50)	(-50)
				(-50)	(-50)	(-50)	(-50)	(-50)	(-50)	(-50)	(-50)	(-50)	(-50)	(-50)	(-50)	(-50)	(-50)	(-50)	(-50)	(-50)	(-50)
				(-50)	(-50)	(-50)	(-50)	(-50)	(-50)	(-50)	(-50)	(-50)	(-50)	(-50)	(-50)	(-50)	(-50)	(-50)	(-50)	(-50)	(-50)
				(-50)	(-50)	(-50)	(-50)	(-50)	(-50)	(-50)	(-50)	(-50)	(-50)	(-50)	(-50)	(-50)	(-50)	(-50)	(-50)	(-50)	(-50)
				(-50)	(-50)	(-50)	(-50)	(-50)	(-50)	(-50)	(-50)	(-50)	(-50)	(-50)	(-50)	(-50)	(-50)	(-50)	(-50)	(-50)	(-50)
				(-50)	(-50)	(-50)	(-50)	(-50)	(-50)	(-50)	(-50)	(-50)	(-50)	(-50)	(-50)	(-50)	(-50)	(-50)	(-50)	(-50)	(-50)
				(-50)	(-50)	(-50)	(-50)	(-50)	(-50)	(-50)	(-50)	(-50)	(-50)	(-50)	(-50)	(-50)	(-50)	(-50)	(-50)	(-50)	(-50)
				(-50)	(-50)	(-50)	(-50)	(-50)	(-50)	(-50)	(-50)	(-50)	(-50)	(-50)	(-50)	(-50)	(-50)	(-50)	(-50)	(-50)	(-50)
				(-50)	(-50)	(-50)	(-50)	(-50)	(-50)	(-50)	(-50)	(-50)	(-50)	(-50)	(-50)	(-50)	(-50)	(-50)	(-50)	(-50)	(-50)
				(-50)	(-50)	(-50)	(-50)	(-50)	(-50)	(-50)	(-50)	(-50)	(-50)	(-50)	(-50)	(-50)	(-50)	(-50)	(-50)	(-50)	(-50)
				(-50)	(-50)	(-50)	(-50)	(-50)	(-50)	(-50)	(-50)	(-50)	(-50)	(-50)	(-50)	(-50)	(-50)	(-50)	(-50)	(-50)	(-50)
				(-50)	(-50)	(-50)	(-50)	(-50)	(-50)	(-50)	(-50)	(-50)	(-50)	(-50)	(-50)	(-50)	(-50)	(-50)	(-50)	(-50)	(-50)
				(-50)	(-50)	(-50)	(-50)	(-50)	(-50)	(-50)	(-50)	(-50)	(-50)	(-50)	(-50)	(-50)	(-50)	(-50)	(-50)	(-50)	(-50)
				>;

			PS_Config_Diff_Test_Frame = <50>;
		};
	};
};
