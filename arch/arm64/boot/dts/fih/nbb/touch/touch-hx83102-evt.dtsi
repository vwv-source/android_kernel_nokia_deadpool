&i2c_3 {
status = "okay";
    himax-incell-ts@48 {
            compatible = "himax,hx83102_i2c";
            reg = <0x48>;
            interrupt-parent = <&tlmm>;
            interrupts = <65 0x2>;
            himax,rst-gpio = <&tlmm 64 0x00>;
            himax,irq-gpio = <&tlmm 65 0x00>;
            himax,display-coords =  <0 720 0 1440>;
            himax,panel-coords = <0 720 0 1440>;
            report_type = <1>;
    };
};
