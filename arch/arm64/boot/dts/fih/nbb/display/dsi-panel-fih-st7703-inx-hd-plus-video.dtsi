/* Copyright (c) 2018, The Linux Foundation. All rights reserved.
 *
 * This program is free software; you can redistribute it and/or modify
 * it under the terms of the GNU General Public License version 2 and
 * only version 2 as published by the Free Software Foundation.
 *
 * This program is distributed in the hope that it will be useful,
 * but WITHOUT ANY WARRANTY; without even the implied warranty of
 * MERCHANTABILITY or FITNESS FOR A PARTICULAR PURPOSE.  See the
 * GNU General Public License for more details.
 */

&mdss_mdp {
	dsi_st7703_inx_hd_plus_vid: fih,mdss_dsi_st7703_inx_hd_plus_video{
		fih,panel-id = <5>;
		qcom,mdss-dsi-panel-name = "SITRONIX ST7703 video mode dsi hd plus (720x1440) inx panel";
		qcom,mdss-dsi-panel-type = "dsi_video_mode";
		qcom,mdss-dsi-panel-framerate = <60>;
		qcom,mdss-dsi-virtual-channel-id = <0>;
		qcom,mdss-dsi-stream = <0>;
		qcom,mdss-dsi-panel-width = <720>;
		qcom,mdss-dsi-panel-height = <1440>;

		qcom,mdss-dsi-h-front-porch = <40>;
		qcom,mdss-dsi-h-back-porch = <40>;
		qcom,mdss-dsi-h-pulse-width = <20>;
		qcom,mdss-dsi-h-sync-skew = <0>;
		qcom,mdss-dsi-v-front-porch = <13>;
		qcom,mdss-dsi-v-back-porch = <12>;
		qcom,mdss-dsi-v-pulse-width = <4>;

		qcom,mdss-dsi-h-left-border = <0>;
		qcom,mdss-dsi-h-right-border = <0>;
		qcom,mdss-dsi-v-top-border = <0>;
		qcom,mdss-dsi-v-bottom-border = <0>;
		qcom,mdss-dsi-bpp = <24>;
		qcom,mdss-dsi-color-order = "rgb_swap_rgb";
		qcom,mdss-dsi-underflow-color = <0xff>;
		qcom,mdss-dsi-border-color = <0>;
		qcom,mdss-dsi-on-command = [
			05 01 00 00 82 00 02 11 00
			39 01 00 00 00 00 04 B9 F1 12 83
			39 01 00 00 00 00 1C BA 33 81 05 F9 0E 0E 20 00 00 00 00 00 00 00 44 25 00 91 0A 00 00 02 4F 01 00 00 37
			39 01 00 00 00 00 02 B8 75
			39 01 00 00 00 00 04 BF 02 11 00
			39 01 00 00 00 00 0B B3 0C 10 0A 50 03 FF 00 00 00 00
			39 01 00 00 00 00 0A C0 73 73 50 50 00 00 08 70 00
			39 01 00 00 00 00 02 BC 46
			39 01 00 00 00 00 02 CC 0B
			39 01 00 00 00 00 04 C6 02 40 FF
			39 01 00 00 00 00 02 B4 80
			39 01 00 00 00 00 04 B2 F0 12 30
			39 01 00 00 00 00 0F E3 03 03 03 03 03 03 00 00 00 00 FF 80 C0 10
			39 01 00 00 00 00 0D C1 65 00 1E 1E 77 F1 88 88 55 55 33 33
			39 01 00 00 00 00 03 B5 1D 1D
			39 01 00 00 00 00 03 B6 7C 7C
			39 01 00 00 00 00 40 E9 02 00 0A 05 AE B0 B0 12 31 45 4F 0C B0 B0 4B 0C 00 00 0D 00 00 00 00 00 1A 00 00 00 08 64 AB 02 48 18 38 88 88 85 88 81 87 5A B1 38 08 28 88 84 86 88 00 40 00 01 12 B0 B0 4B 0A 14 00 00 00
			39 01 00 00 00 00 3E EA 96 00 01 01 00 36 00 00 00 00 00 00 58 71 AB 64 28 08 38 88 88 81 88 84 86 0A B5 38 18 48 88 82 80 88 23 00 00 00 04 00 00 00 05 C0 00 00 00 00 00 00 00 00 00 00 40 B0 B0 00 00 00 00
			39 01 00 00 00 00 23 E0 00 09 0D 21 26 3F 3D 33 07 0C 0D 11 14 11 12 10 17 00 09 0D 21 26 3F 3D 33 07 0C 0D 11 14 11 12 10 17
			05 01 00 00 0A 00 02 29 00
		];
		qcom,mdss-dsi-off-command = [
			05 01 00 00 14 00 02 28 00
			05 01 00 00 96 00 02 10 00
		];
		qcom,mdss-dsi-on-command-state = "dsi_lp_mode";
		qcom,mdss-dsi-off-command-state = "dsi_hs_mode";
		qcom,mdss-dsi-h-sync-pulse = <0>;
		qcom,mdss-dsi-traffic-mode = "non_burst_sync_event";
		qcom,mdss-dsi-lane-map = "lane_map_0123";
		qcom,mdss-dsi-bllp-eof-power-mode;
		qcom,mdss-dsi-bllp-power-mode;
		qcom,mdss-dsi-tx-eot-append;
		qcom,mdss-dsi-lane-0-state;
		qcom,mdss-dsi-lane-1-state;
		qcom,mdss-dsi-lane-2-state;
		qcom,mdss-dsi-lane-3-state;
		qcom,mdss-dsi-t-clk-post = <0x04>;
		qcom,mdss-dsi-t-clk-pre = <0x1A>;
		qcom,mdss-dsi-dma-trigger = "trigger_sw";
		qcom,mdss-dsi-mdp-trigger = "none";
		qcom,mdss-dsi-reset-sequence = <1 10>, <0 5>, <1 20>;

		qcom,mdss-dsi-lp11-init;

		qcom,mdss-pan-physical-width-dimension = <61>;
		qcom,mdss-pan-physical-height-dimension = <123>;
		qcom,mdss-pan-physical-width-dimension-full = <6188>;
		qcom,mdss-pan-physical-height-dimension-full = <12377>;

		/* ******************** */
		/* START of Dynamic Read Write Register */
		/* ******************** */
		/* SW4-HL-Display-DynamicReadWriteRegister-00+{_20160729 */
		fih,mdss-dsi-write-reg-command = [
			39 01 00 00 00 00 04 FF 78 07 00
		];

		fih,mdss-dsi-write-reg-command-state = "dsi_lp_mode";
		/* SW4-HL-Display-DynamicReadWriteRegister-00+}_20160729 */
		/* ******************** */
		/* START of Dynamic Read Write Register */
		/* ******************** */
	};
};

&dsi_st7703_inx_hd_plus_vid {
	/delete-property/ qcom,mdss-dsi-panel-timings;
	qcom,mdss-dsi-panel-timings = [
		7A 1A 12 00 40 42 16 1E 14 03 04 00
	];

	qcom,mdss-dsi-panel-timings-phy-v2 = [
		1E 1B 04 06 02 03 04 a0
		1E 1B 04 06 02 03 04 a0
		1E 1B 04 06 02 03 04 a0
		1E 1B 04 06 02 03 04 a0
		1E 1B 04 06 02 03 04 a0
	];

	qcom,mdss-dsi-panel-timings-phy-12nm = [
		09 06 0a 02 00 04 02 08
	];

	qcom,mdss-dsi-bl-pmic-control-type = "bl_ctrl_pwm";
	qcom,mdss-dsi-bl-pmic-pwm-frequency = <40>;
	qcom,mdss-dsi-bl-pmic-bank-select = <0>;
	qcom,mdss-dsi-pwm-gpio = <&pm8953_gpios 8 0>;

	/* PMI439 Can Not Ouput Signal When Frequency Is Set As 25KHZ And Bl Level is less than 4 */
	qcom,mdss-dsi-bl-min-level = <4>;

	qcom,panel-supply-entries = <&dsi_panel_pwr_supply>;

	/******************************************/
	/* ESD Check Recovery  - START */
	/******************************************/
	qcom,esd-check-enabled;
	qcom,mdss-dsi-panel-status-check-mode = "reg_read";
	qcom,mdss-dsi-panel-status-command = [
		06 01 00 01 00 00 01 09
		06 01 00 01 00 00 01 68
	];
	qcom,mdss-dsi-panel-status-command-state = "dsi_lp_mode";
	qcom,mdss-dsi-panel-status-value = <0x80>,<0xC0>;
	qcom,mdss-dsi-panel-on-check-value = <0x80>,<0xC0>;
	qcom,mdss-dsi-panel-status-read-length = <1>,<1>;
	qcom,mdss-dsi-panel-max-error-count = <3>;
	/*****************************************/
	/* ESD Check Recovery  - END     */
	/*****************************************/
		};

