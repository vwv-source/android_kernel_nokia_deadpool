/* Copyright (c) 2018, The Linux Foundation. All rights reserved.
 *
 * This program is free software; you can redistribute it and/or modify
 * it under the terms of the GNU General Public License version 2 and
 * only version 2 as published by the Free Software Foundation.
 *
 * This program is distributed in the hope that it will be useful,
 * but WITHOUT ANY WARRANTY; without even the implied warranty of
 * MERCHANTABILITY or FITNESS FOR A PARTICULAR PURPOSE.  See the
 * GNU General Public License for more details.
 */

&mdss_mdp {
	dsi_hx83102_inno_hd_plus_vid: fih,mdss_dsi_hx83102_inno_hd_plus_video{
		fih,panel-id = <2>;
		qcom,mdss-dsi-panel-name = "HIMAX hx83102 video  mode dsi hd plus (720x1440) inno panel";
		qcom,mdss-dsi-panel-type = "dsi_video_mode";
		qcom,mdss-dsi-panel-framerate = <60>;
		qcom,mdss-dsi-virtual-channel-id = <0>;
		qcom,mdss-dsi-stream = <0>;
		qcom,mdss-dsi-panel-width = <720>;
		qcom,mdss-dsi-panel-height = <1440>;

		qcom,mdss-dsi-h-front-porch = <32>;
		qcom,mdss-dsi-h-back-porch = <32>;
		qcom,mdss-dsi-h-pulse-width = <12>;
		qcom,mdss-dsi-h-sync-skew = <0>;
		qcom,mdss-dsi-v-front-porch = <160>;
		qcom,mdss-dsi-v-back-porch = <6>;
		qcom,mdss-dsi-v-pulse-width = <2>;

		qcom,mdss-dsi-h-left-border = <0>;
		qcom,mdss-dsi-h-right-border = <0>;
		qcom,mdss-dsi-v-top-border = <0>;
		qcom,mdss-dsi-v-bottom-border = <0>;
		qcom,mdss-dsi-bpp = <24>;
		qcom,mdss-dsi-color-order = "rgb_swap_rgb";
		qcom,mdss-dsi-underflow-color = <0xff>;
		qcom,mdss-dsi-border-color = <0>;
		qcom,mdss-dsi-on-command = [
			39 01 00 00 05 00 04 B9 83 10 2D
			39 01 00 00 05 00 0C B1 20 22 27 27 32 72 57 43 18 18 18
			39 01 00 00 05 00 0F B2 00 00 05 A0 00 08 A0 42 00 00 00 00 14 60
			39 01 00 00 05 00 0F B4 01 60 01 60 01 60 01 60 03 FF 01 20 00 FF
			39 01 00 00 05 00 02 CC 02
			39 01 00 00 05 00 1A D3 77 22 3C 03 00 0C 00 3B 00 33 37 06 06 00 00 32 10 04 00 04 54 15 A6 05 A6
			39 01 00 00 05 00 2D D5 20 21 24 25 18 18 18 18 26 27 1A 1A 1B 1B 00 01 02 03 04 05 06 07 08 09 0A 0B 18 18 18 18 18 18 18 18 18 18 18 18 18 18 18 18 18 18
			39 01 00 00 05 00 2D D6 25 24 21 20 18 18 18 18 27 26 1A 1A 1B 1B 0B 0A 09 08 07 06 05 04 03 02 01 00 18 18 18 18 18 18 18 18 18 18 18 18 18 18 18 18 18 18
			39 01 00 00 05 00 05 E7 FF 0F 00 00
			39 01 00 00 05 00 02 BD 01
			39 01 00 00 05 00 02 E7 01
			39 01 00 00 05 00 02 BD 00
			39 01 00 00 05 00 04 B6 90 90 E0
			39 01 00 00 05 00 2F E0 00 01 06 0B 0E 11 23 27 2B 26 3E 42 47 57 55 60 6B 82 86 45 50 5E 7F 00 01 06 0B 0E 11 23 27 2B 26 3E 42 47 57 55 60 6B 82 86 45 50 5E 7F
			39 01 00 00 05 00 14 BA 70 23 A8 9B B2 80 80 01 10 00 00 00 08 3D 82 77 04 01 00
			39 01 00 00 05 00 02 BD 01
			39 01 00 00 05 00 02 CB 01
			39 01 00 00 05 00 02 BD 00
			39 01 00 00 05 00 08 BF FC 00 25 90 F6 00 45
			39 01 00 00 05 00 02 BD 01
			39 01 00 00 05 00 04 D3 01 00 7D
			39 01 00 00 05 00 02 BD 00
			39 01 00 00 05 00 04 DE 02 00 23
			39 01 00 00 05 00 02 BD 02
			39 01 00 00 05 00 09 B4 C2 00 33 00 33 88 B3 00
			39 01 00 00 05 00 02 BD 00
			05 01 00 00 78 00 02 11 00
			05 01 00 00 0A 00 02 29 00
		];
		qcom,mdss-dsi-off-command = [
			05 01 00 00 14 00 02 28 00
			05 01 00 00 78 00 02 10 00
		];
		qcom,mdss-dsi-on-command-state = "dsi_lp_mode";
		qcom,mdss-dsi-off-command-state = "dsi_hs_mode";
		qcom,mdss-dsi-h-sync-pulse = <0>;
		qcom,mdss-dsi-traffic-mode = "non_burst_sync_event";
		qcom,mdss-dsi-lane-map = "lane_map_0123";
		qcom,mdss-dsi-bllp-eof-power-mode;
		qcom,mdss-dsi-bllp-power-mode;
		qcom,mdss-dsi-tx-eot-append;
		qcom,mdss-dsi-lane-0-state;
		qcom,mdss-dsi-lane-1-state;
		qcom,mdss-dsi-lane-2-state;
		qcom,mdss-dsi-lane-3-state;
		qcom,mdss-dsi-t-clk-post = <0x04>;
		qcom,mdss-dsi-t-clk-pre = <0x1A>;
		qcom,mdss-dsi-dma-trigger = "trigger_sw";
		qcom,mdss-dsi-mdp-trigger = "none";
		qcom,mdss-dsi-lp11-init;
		qcom,mdss-dsi-reset-sequence = <1 15>;

		qcom,mdss-pan-physical-width-dimension = <68>;
		qcom,mdss-pan-physical-height-dimension = <136>;
		qcom,mdss-pan-physical-width-dimension-full = <6804>;
		qcom,mdss-pan-physical-height-dimension-full = <13608>;

		/* ******************** */
		/* START of CABC */
		/* ******************** */
		qcom,mdss-dsi-cabc-off-command = [
			39 01 00 00 00 00 02 55 00
		];

		qcom,mdss-dsi-cabc-ui-command = [
			39 01 00 00 00 00 02 55 01
		];

		qcom,mdss-dsi-cabc-still-command = [
			39 01 00 00 00 00 02 55 02
		];

		qcom,mdss-dsi-cabc-moving-command = [
			39 01 00 00 00 00 02 55 03
		];

		qcom,mdss-dsi-cabc-off-command-state = "dsi_hs_mode";
		qcom,mdss-dsi-cabc-ui-command-state = "dsi_hs_mode";
		qcom,mdss-dsi-cabc-still-command-state = "dsi_hs_mode";
		qcom,mdss-dsi-cabc-moving-command-state = "dsi_hs_mode";

		qcom,mdss-dsi-cabc-off-command-BeforeInit = [
			39 01 00 00 00 00 02 55 00
		];

		qcom,mdss-dsi-cabc-ui-command-BeforeInit = [
			39 01 00 00 00 00 02 55 01
		];

		qcom,mdss-dsi-cabc-still-command-BeforeInit = [
			39 01 00 00 00 00 02 55 02
		];

		qcom,mdss-dsi-cabc-moving-command-BeforeInit = [
			39 01 00 00 00 00 02 55 03
		];

		qcom,mdss-dsi-cabc-off-command-BeforeInit-state = "dsi_lp_mode";
		qcom,mdss-dsi-cabc-ui-command-BeforeInit-state = "dsi_lp_mode";
		qcom,mdss-dsi-cabc-still-command-BeforeInit-state = "dsi_lp_mode";
		qcom,mdss-dsi-cabc-moving-command-BeforeInit-state = "dsi_lp_mode";
		/* ******************** */
		/* END of CABC */
		/* ******************** */

		/* ******************** */
		/* START of Dynamic Read Write Register */
		/* ******************** */
		/* SW4-HL-Display-DynamicReadWriteRegister-00+{_20160729 */
		fih,mdss-dsi-write-reg-command = [
			39 01 00 00 00 00 04 FF 78 07 00
		];

		fih,mdss-dsi-write-reg-command-state = "dsi_lp_mode";
		/* SW4-HL-Display-DynamicReadWriteRegister-00+}_20160729 */
		/* ******************** */
		/* START of Dynamic Read Write Register */
		/* ******************** */
	};
};

&dsi_hx83102_inno_hd_plus_vid {
	/delete-property/ qcom,mdss-dsi-panel-timings;
	qcom,mdss-dsi-panel-timings = [
		87 1C 12 00 42 44 18 20 17 03 04 00
	];

	qcom,mdss-dsi-panel-timings-phy-v2 = [
		1E 1C 04 06 02 03 04 a0
		1E 1C 04 06 02 03 04 a0
		1E 1C 04 06 02 03 04 a0
		1E 1C 04 06 02 03 04 a0
		1E 1C 04 06 02 03 04 a0
	];

	qcom,mdss-dsi-panel-timings-phy-12nm = [
		08 06 0a 02 00 04 02 08
	];

	qcom,mdss-dsi-bl-pmic-control-type = "bl_ctrl_pwm";
	qcom,mdss-dsi-bl-pmic-pwm-frequency = <100>;
	qcom,mdss-dsi-bl-pmic-bank-select = <0>;
	qcom,mdss-dsi-pwm-gpio = <&pm8953_gpios 8 0>;

	qcom,panel-supply-entries = <&dsi_panel_pwr_supply>;
};

