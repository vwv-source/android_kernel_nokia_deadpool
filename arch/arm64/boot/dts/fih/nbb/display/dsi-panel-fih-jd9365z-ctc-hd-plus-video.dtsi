/* Copyright (c) 2018, The Linux Foundation. All rights reserved.
 *
 * This program is free software; you can redistribute it and/or modify
 * it under the terms of the GNU General Public License version 2 and
 * only version 2 as published by the Free Software Foundation.
 *
 * This program is distributed in the hope that it will be useful,
 * but WITHOUT ANY WARRANTY; without even the implied warranty of
 * MERCHANTABILITY or FITNESS FOR A PARTICULAR PURPOSE.  See the
 * GNU General Public License for more details.
 */

&mdss_mdp {
	dsi_jd9365z_ctc_hd_plus_vid: fih,mdss_dsi_jd9365z_ctc_hd_plus_video{
		fih,panel-id = <6>;
		qcom,mdss-dsi-panel-name = "FITI JD9365Z video mode dsi hd plus (720x1440) CTC panel";
		qcom,mdss-dsi-panel-type = "dsi_video_mode";
		qcom,mdss-dsi-panel-framerate = <60>;
		qcom,mdss-dsi-virtual-channel-id = <0>;
		qcom,mdss-dsi-stream = <0>;
		qcom,mdss-dsi-panel-width = <720>;
		qcom,mdss-dsi-panel-height = <1440>;

		qcom,mdss-dsi-h-front-porch = <20>;
		qcom,mdss-dsi-h-back-porch = <20>;
		qcom,mdss-dsi-h-pulse-width = <20>;
		qcom,mdss-dsi-h-sync-skew = <0>;
		qcom,mdss-dsi-v-front-porch = <14>;
		qcom,mdss-dsi-v-back-porch = <10>;
		qcom,mdss-dsi-v-pulse-width = <4>;

		qcom,mdss-dsi-h-left-border = <0>;
		qcom,mdss-dsi-h-right-border = <0>;
		qcom,mdss-dsi-v-top-border = <0>;
		qcom,mdss-dsi-v-bottom-border = <0>;
		qcom,mdss-dsi-bpp = <24>;
		qcom,mdss-dsi-color-order = "rgb_swap_rgb";
		qcom,mdss-dsi-underflow-color = <0xff>;
		qcom,mdss-dsi-border-color = <0>;
		qcom,mdss-dsi-on-command = [
			05 01 00 00 F0 00 02 11 00
			39 01 00 00 00 00 04 DF 93 65 F8
			39 01 00 00 00 00 05 B9 00 C4 13 02                       
			39 01 00 00 00 00 07 C3 04 00 00 6E 00 6F                     
			39 01 00 00 00 00 07 C4 24 D0 B4 75 0E 0D                     
			39 01 00 00 00 00 17 D4 01 10 00 04 04 20 01 02 5D 5D 00 00 00 01 02 03 60 72 06 49 49 10     
			39 01 00 00 00 00 1C D5 00 00 00 00 30 00 00 06 60 00 88 50 04 55 BB 38 00 1F 00 00 00 03 60 E4 06 50 00
			39 01 00 00 00 00 04 DF 00 00 00
			05 01 00 00 0A 00 02 29 00
		];
		qcom,mdss-dsi-off-command = [
			05 01 00 00 14 00 02 28 00
			05 01 00 00 96 00 02 10 00
		];
		qcom,mdss-dsi-on-command-state = "dsi_lp_mode";
		qcom,mdss-dsi-off-command-state = "dsi_hs_mode";
		qcom,mdss-dsi-h-sync-pulse = <0>;
		qcom,mdss-dsi-traffic-mode = "non_burst_sync_event";
		qcom,mdss-dsi-lane-map = "lane_map_0123";
		qcom,mdss-dsi-bllp-eof-power-mode;
		qcom,mdss-dsi-bllp-power-mode;
		qcom,mdss-dsi-tx-eot-append;
		qcom,mdss-dsi-lane-0-state;
		qcom,mdss-dsi-lane-1-state;
		qcom,mdss-dsi-lane-2-state;
		qcom,mdss-dsi-lane-3-state;
		qcom,mdss-dsi-t-clk-post = <0x04>;
		qcom,mdss-dsi-t-clk-pre = <0x1A>;
		qcom,mdss-dsi-dma-trigger = "trigger_sw";
		qcom,mdss-dsi-mdp-trigger = "none";
		qcom,mdss-dsi-lp11-init;
		qcom,mdss-dsi-reset-sequence = <1 5>, <0 5>, <1 20>;

		qcom,mdss-pan-physical-width-dimension = <61>;
		qcom,mdss-pan-physical-height-dimension = <123>;
		qcom,mdss-pan-physical-width-dimension-full = <6188>;
		qcom,mdss-pan-physical-height-dimension-full = <12377>;

		/* ******************** */
		/* START of Dynamic Read Write Register */
		/* ******************** */
		/* SW4-HL-Display-DynamicReadWriteRegister-00+{_20160729 */
		fih,mdss-dsi-write-reg-command = [
			39 01 00 00 00 00 04 FF 78 07 00
		];

		fih,mdss-dsi-write-reg-command-state = "dsi_lp_mode";
		/* SW4-HL-Display-DynamicReadWriteRegister-00+}_20160729 */
		/* ******************** */
		/* START of Dynamic Read Write Register */
		/* ******************** */
	};
};

&dsi_jd9365z_ctc_hd_plus_vid {
	/delete-property/ qcom,mdss-dsi-panel-timings;
	qcom,mdss-dsi-panel-timings = [
		7B 1A 10 00 3E 40 16 1C 15 03 04 00
	];

	qcom,mdss-dsi-panel-timings-phy-v2 = [
		1E 1B 04 06 02 03 04 a0
		1E 1B 04 06 02 03 04 a0
		1E 1B 04 06 02 03 04 a0
		1E 1B 04 06 02 03 04 a0
		1E 1B 04 06 02 03 04 a0
	];

	qcom,mdss-dsi-panel-timings-phy-12nm = [
		08 06 09 02 00 04 02 07
	];

	qcom,mdss-dsi-bl-pmic-control-type = "bl_ctrl_pwm";
	qcom,mdss-dsi-bl-pmic-pwm-frequency = <40>;
	qcom,mdss-dsi-bl-pmic-bank-select = <0>;
	qcom,mdss-dsi-pwm-gpio = <&pm8953_gpios 8 0>;

	/* PMI439 Can Not Ouput Signal When Frequency Is Set As 25KHZ And Bl Level is less than 4 */
	qcom,mdss-dsi-bl-min-level = <4>;
	
	qcom,panel-supply-entries = <&dsi_panel_pwr_supply>;

	/******************************************/
	/* ESD Check Recovery  - START */
	/******************************************/
	qcom,esd-check-enabled;
	qcom,mdss-dsi-panel-status-check-mode = "reg_read";
	qcom,mdss-dsi-panel-status-command = [
		06 01 00 01 00 00 01 0A
	];
	qcom,mdss-dsi-panel-status-command-state = "dsi_lp_mode";
	qcom,mdss-dsi-panel-status-value = <0x1C>;
	qcom,mdss-dsi-panel-on-check-value = <0x1C>;
	qcom,mdss-dsi-panel-status-read-length = <1>;
	qcom,mdss-dsi-panel-max-error-count = <3>;
	/*****************************************/
	/* ESD Check Recovery  - END     */
	/*****************************************/
		};

