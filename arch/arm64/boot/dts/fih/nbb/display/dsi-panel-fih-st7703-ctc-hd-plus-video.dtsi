/* Copyright (c) 2018, The Linux Foundation. All rights reserved.
 *
 * This program is free software; you can redistribute it and/or modify
 * it under the terms of the GNU General Public License version 2 and
 * only version 2 as published by the Free Software Foundation.
 *
 * This program is distributed in the hope that it will be useful,
 * but WITHOUT ANY WARRANTY; without even the implied warranty of
 * MERCHANTABILITY or FITNESS FOR A PARTICULAR PURPOSE.  See the
 * GNU General Public License for more details.
 */

&mdss_mdp {
	dsi_st7703_ctc_hd_plus_vid: fih,mdss_dsi_st7703_ctc_hd_plus_video{
		fih,panel-id = <3>;
                qcom,mdss-dsi-panel-name = "SITRONIX ST7703 video mode dsi hd plus (720x1440) ctc panel";
		qcom,mdss-dsi-panel-type = "dsi_video_mode";
		qcom,mdss-dsi-panel-framerate = <60>;
		qcom,mdss-dsi-virtual-channel-id = <0>;
		qcom,mdss-dsi-stream = <0>;
		qcom,mdss-dsi-panel-width = <720>;
		qcom,mdss-dsi-panel-height = <1440>;

		qcom,mdss-dsi-h-front-porch = <40>;
		qcom,mdss-dsi-h-back-porch = <40>;
		qcom,mdss-dsi-h-pulse-width = <10>;
		qcom,mdss-dsi-h-sync-skew = <0>;
		qcom,mdss-dsi-v-front-porch = <17>;
		qcom,mdss-dsi-v-back-porch = <11>;
		qcom,mdss-dsi-v-pulse-width = <4>;

		qcom,mdss-dsi-h-left-border = <0>;
		qcom,mdss-dsi-h-right-border = <0>;
		qcom,mdss-dsi-v-top-border = <0>;
		qcom,mdss-dsi-v-bottom-border = <0>;
		qcom,mdss-dsi-bpp = <24>;
		qcom,mdss-dsi-color-order = "rgb_swap_rgb";
		qcom,mdss-dsi-underflow-color = <0xff>;
		qcom,mdss-dsi-border-color = <0>;
		qcom,mdss-dsi-on-command = [
			39 01 00 00 00 00 04 B9 F1 12 83
			39 01 00 00 00 00 1C BA 33 81 05 F9 0E 0E 20 00 00 00 00 00 00 00 44 25 00 91 0A 00 00 02 4F D1 00 00 37
			39 01 00 00 00 00 02 B8 76
			39 01 00 00 00 00 04 BF 02 11 00
			39 01 00 00 00 00 0B B3 0C 10 0A 50 03 FF 00 00 00 00
			39 01 00 00 00 00 0A C0 73 73 50 50 00 00 08 70 00
			39 01 00 00 00 00 02 BC 46
			39 01 00 00 00 00 02 CC 0B
			39 01 00 00 00 00 02 B4 80
			39 01 00 00 00 00 04 B2 F0 12 F0
			39 01 00 00 00 00 0F E3 07 07 0B 0B 03 0B 00 00 00 00 FF 00 C0 10
			39 01 00 00 00 00 0D C1 74 00 1E 1E 77 F1 CC DD 67 77 33 33
			39 01 00 00 00 00 03 B5 10 10 
			39 01 00 00 00 00 03 B6 91 91
			39 01 00 00 00 00 40 E9 C2 10 07 00 00 12 B5 12 31 23 18 85 12 B5 17 10 00 00 30 04 00 00 00 00 30 04 00 00 64 20 08 88 88 88 88 88 88 BA 88 75 31 18 88 88 88 88 88 88 BA 88 00 00 00 01 00 00 00 00 00 00 00 00 00
			39 01 00 00 00 00 3E EA 03 12 82 02 02 07 00 00 00 00 00 00 57 13 81 88 88 88 88 88 88 BA 88 46 02 80 88 88 88 88 88 88 BA 88 23 10 00 00 54 00 00 00 00 00 00 00 00 00 00 00 00 00 00 00 00 00 00 00 00 00 00
			39 01 00 00 00 00 23 E0 00 0D 12 30 3B 3F 44 3F 07 0D 0E 12 14 12 14 11 1C 00 0D 12 30 3B 3F 44 3F 07 0D 0E 12 14 12 14 11 1C
			39 01 00 00 00 00 02 C7 B0
			39 01 00 00 00 00 03 C8 00 04			
			39 01 00 00 00 00 02 51 FF
			39 01 00 00 00 00 02 53 2C			
			05 01 00 00 82 00 02 11 00
			05 01 00 00 0A 00 02 29 00		
		];
		qcom,mdss-dsi-off-command = [
			05 01 00 00 14 00 02 28 00
			05 01 00 00 96 00 02 10 00
		];
		qcom,mdss-dsi-on-command-state = "dsi_lp_mode";
		qcom,mdss-dsi-off-command-state = "dsi_hs_mode";
		qcom,mdss-dsi-h-sync-pulse = <0>;
		qcom,mdss-dsi-traffic-mode = "non_burst_sync_event";
		qcom,mdss-dsi-lane-map = "lane_map_0123";
		qcom,mdss-dsi-bllp-eof-power-mode;
		qcom,mdss-dsi-bllp-power-mode;
		qcom,mdss-dsi-tx-eot-append;
		qcom,mdss-dsi-lane-0-state;
		qcom,mdss-dsi-lane-1-state;
		qcom,mdss-dsi-lane-2-state;
		qcom,mdss-dsi-lane-3-state;
		qcom,mdss-dsi-t-clk-post = <0x0a>;
		qcom,mdss-dsi-t-clk-pre = <0x1d>;
		qcom,mdss-dsi-dma-trigger = "trigger_sw";
                qcom,mdss-dsi-mdp-trigger = "none";
		qcom,mdss-dsi-reset-sequence = <1 10>, <0 5>, <1 20>;

		qcom,mdss-pan-physical-width-dimension = <61>;
		qcom,mdss-pan-physical-height-dimension = <123>;
		qcom,mdss-pan-physical-width-dimension-full = <6188>;
		qcom,mdss-pan-physical-height-dimension-full = <12377>;

		/* ******************** */
		/* START of CABC */
		/* ******************** */
		qcom,mdss-dsi-cabc-off-command = [
			39 01 00 00 00 00 02 55 00
		];

		qcom,mdss-dsi-cabc-ui-command = [
			39 01 00 00 00 00 02 55 01
		];

		qcom,mdss-dsi-cabc-still-command = [
			39 01 00 00 00 00 02 55 02
		];

		qcom,mdss-dsi-cabc-moving-command = [
			39 01 00 00 00 00 02 55 03
		];

		qcom,mdss-dsi-cabc-off-command-state = "dsi_hs_mode";
		qcom,mdss-dsi-cabc-ui-command-state = "dsi_hs_mode";
		qcom,mdss-dsi-cabc-still-command-state = "dsi_hs_mode";
		qcom,mdss-dsi-cabc-moving-command-state = "dsi_hs_mode";

		qcom,mdss-dsi-cabc-off-command-BeforeInit = [
			39 01 00 00 00 00 02 55 00
		];

		qcom,mdss-dsi-cabc-ui-command-BeforeInit = [
			39 01 00 00 00 00 02 55 01
		];

		qcom,mdss-dsi-cabc-still-command-BeforeInit = [
			39 01 00 00 00 00 02 55 02
		];

		qcom,mdss-dsi-cabc-moving-command-BeforeInit = [
			39 01 00 00 00 00 02 55 03
		];

		qcom,mdss-dsi-cabc-off-command-BeforeInit-state = "dsi_lp_mode";
		qcom,mdss-dsi-cabc-ui-command-BeforeInit-state = "dsi_lp_mode";
		qcom,mdss-dsi-cabc-still-command-BeforeInit-state = "dsi_lp_mode";
		qcom,mdss-dsi-cabc-moving-command-BeforeInit-state = "dsi_lp_mode";
		/* ******************** */
		/* END of CABC */
		/* ******************** */

		/* ******************** */
		/* START of Dynamic Read Write Register */
		/* ******************** */
		/* SW4-HL-Display-DynamicReadWriteRegister-00+{_20160729 */
		fih,mdss-dsi-write-reg-command = [
			39 01 00 00 00 00 04 FF 78 07 00
		];

		fih,mdss-dsi-write-reg-command-state = "dsi_lp_mode";
		/* SW4-HL-Display-DynamicReadWriteRegister-00+}_20160729 */
		/* ******************** */
		/* START of Dynamic Read Write Register */
		/* ******************** */
	};
};

&dsi_st7703_ctc_hd_plus_vid {
	/delete-property/ qcom,mdss-dsi-panel-timings;
	qcom,mdss-dsi-panel-timings = [
		7A 1A 12 00 3E 42 16 1E 14 03 04 00
	];

	qcom,mdss-dsi-panel-timings-phy-v2 = [
		1E 1B 04 06 02 03 04 a0
		1E 1B 04 06 02 03 04 a0
		1E 1B 04 06 02 03 04 a0
		1E 1B 04 06 02 03 04 a0
		1E 1B 04 06 02 03 04 a0
	];

	qcom,mdss-dsi-panel-timings-phy-12nm = [
		08 06 0a 02 00 04 02 08
	];

	qcom,mdss-dsi-bl-pmic-control-type = "bl_ctrl_pwm";
	qcom,mdss-dsi-bl-pmic-pwm-frequency = <100>;
	qcom,mdss-dsi-bl-pmic-bank-select = <0>;
	qcom,mdss-dsi-pwm-gpio = <&pm8953_gpios 8 0>;

	qcom,panel-supply-entries = <&dsi_panel_pwr_supply>;

	/******************************************/
	/* ESD Check Recovery  - START */
	/******************************************/
	/*
	qcom,esd-check-enabled;
	qcom,mdss-dsi-panel-status-check-mode = "reg_read";
	qcom,mdss-dsi-panel-status-command = [
		06 01 00 01 00 00 01 09
		06 01 00 01 00 00 01 68
	];
	qcom,mdss-dsi-panel-status-command-state = "dsi_lp_mode";
	qcom,mdss-dsi-panel-status-value = <0x80>,<0xC0>;
	qcom,mdss-dsi-panel-on-check-value = <0x80>,<0xC0>;
	qcom,mdss-dsi-panel-status-read-length = <1>,<1>;
	qcom,mdss-dsi-panel-max-error-count = <3>;
	*/
	/*****************************************/
	/* ESD Check Recovery  - END     */
	/*****************************************/
		};
