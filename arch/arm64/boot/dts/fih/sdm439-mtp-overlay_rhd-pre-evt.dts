/*
 * Copyright (c) 2018, The Linux Foundation. All rights reserved.
 *
 * This program is free software; you can redistribute it and/or modify
 * it under the terms of the GNU General Public License version 2 and
 * only version 2 as published by the Free Software Foundation.
 *
 * This program is distributed in the hope that it will be useful,
 * but WITHOUT ANY WARRANTY; without even the implied warranty of
 * MERCHANTABILITY or FITNESS FOR A PARTICULAR PURPOSE.  See the
 * GNU General Public License for more details.
 */

/dts-v1/;
/plugin/;

#include <dt-bindings/clock/msm-clocks-8952.h>
#include "../qcom/sdm439-mtp.dtsi"

#include "nbb/rhd-preEVT.dtsi"

/ {
	model = "SDM439 MTP RHD pre-EVT";
	compatible = "qcom,sdm439-mtp", "qcom,sdm439", "qcom,mtp";
	qcom,msm-id = <353 0x0>;
	qcom,board-id = <8 0>;
  fih,hw-id = <2 1 0>;
};

&int_codec {
    qcom,model = "sdm439-snd-card-rhd";
    fih,msm-btn-vol-thr-low = <112 250 425 425 425>;
    fih,msm-btn-vol-thr-high = <112 250 437 437 437>;
};
